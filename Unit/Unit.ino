/*********
  Split Flap Arduino Nano Unit
*********/

//#define SERIAL_ENABLE // uncomment for serial debug communication
//#define TEST_ENABLE   // uncomment for Test mode. Rotates through a few character to make sure unit is working. These characters should be displayed in the correct order: " ", "Z", "A", "U", "N", "?", "0", "1", "2", "9"

#include <Arduino.h>
#include <Wire.h>
#include <Stepper.h>
#include <EEPROM.h>
#include <avr/sleep.h>
#include <avr/wdt.h>
#include "BuildVersion.h"  // GIT_REV, generated by build_version.py

// Pins of I2C adress switch
#define ADRESSSW1 6
#define ADRESSSW2 5
#define ADRESSSW3 4
#define ADRESSSW4 3

// I2C address 0x00 is reserved (general call); offset every unit's address so
// DIP "0000" maps to 0x01 and DIP "1111" maps to 0x10. The master's
// ESPMaster/ServiceFlapFunctions.ino defines the same constant and must stay
// in sync.
#define I2C_ADDRESS_BASE 1

// EEPROM layout:
//   0..1  int   calibration offset (set via master web-UI calibration)
//   2     byte  identity magic — if == EEPROM_ID_MAGIC_VALUE, byte 3 is valid
//   3     byte  I2C address (1..126) assigned by the position wizard (future)
//   4     byte  lifetime brownout-reset count (saturating)  (issue #47)
//   5     byte  lifetime watchdog-reset count (saturating)  (issue #47)
// Slots 6+ reserved.
#define EEPROM_ADDR_ID_MAGIC      2
#define EEPROM_ADDR_I2C_ADDR      3
#define EEPROM_ADDR_BROWNOUT_CNT  4
#define EEPROM_ADDR_WATCHDOG_CNT  5
#define EEPROM_ID_MAGIC_VALUE     0xA5

// I2C "receive" namespace: the first byte is a letter index (0..AMOUNTFLAPS-1)
// for normal display commands, or a command opcode (>= AMOUNTFLAPS) for
// control commands. Keep opcodes away from letter indices to stay backwards
// compatible with older masters that only know about letters.
//
// Opcodes are organized into semantic bands (issue #47):
//   0x80..0x8F  queries — master writes opcode, follows with requestFrom
//   0x90..0x9F  mutations — master writes opcode + args, no read follow-up
//
// Two opcodes are "forever stable" across protocol bumps because they are
// the cross-generation recovery path:
//   0x80  CMD_ENTER_BOOTLOADER — how a new master updates an old unit
//   0x81  CMD_GET_VERSION      — how the master detects outdated firmware
// Do not renumber these.

// --- Lifecycle & cross-version-stable opcodes ---
#define CMD_ENTER_BOOTLOADER   0x80  // trigger watchdog reset into twiboot

// --- 0x8X queries ---
#define CMD_GET_VERSION        0x81  // next read: 8 bytes GIT_REV (null-padded)
#define CMD_GET_OFFSET         0x82  // next read: 2 bytes int16 LE calOffset
// CMD_GET_STATUS: next read returns 8 bytes of health/diag data, see
// requestEvent() for layout. Introduced in issue #47. Old firmware that
// doesn't know this opcode falls back to the default 1-byte currentlyrotating
// reply; master detects "short response" as "status unsupported".
#define CMD_GET_STATUS         0x83

// --- 0x9X mutations ---
// All mutation opcodes defer heavy work (EEPROM write, motor moves, WDT
// reset) to loop() via `pending*` flags — doing it inside the Wire ISR
// stalls the bus and can drop follow-up transactions.
#define CMD_HOME               0x90  // no args; unit runs full calibrate(true)
#define CMD_JOG                0x91  // +1 signed byte (-127..+127)
#define CMD_REBOOT             0x92  // no args; soft watchdog reset (stays in sketch)
#define CMD_SET_OFFSET         0x93  // +2 bytes int16 LE; persist to EEPROM

//constants stepper
#define STEPPERPIN1 11
#define STEPPERPIN2 10
#define STEPPERPIN3 9
#define STEPPERPIN4 8
#define STEPS 2038 //28BYJ-48 stepper, number of steps
#define HALLPIN 7 //Pin of hall sensor
#define AMOUNTFLAPS 45

//constants others
#define BAUDRATE 115200
#define ROTATIONDIRECTION 1 //-1 for reverse direction (swap if the drum rotates the wrong way)
#define OVERHEATINGTIMEOUT 2 //timeout in seconds to avoid overheating of stepper. After starting rotation, the counter will start. Stepper won't move again until timeout is passed
unsigned long lastRotation = 0;

//globals
int displayedLetter = 0; //currently shown letter
int desiredLetter = 0; //letter to be shown
//Must match ESPMaster.ino's letters[] and script.js's CALIBRATION_LETTERS
//byte-for-byte. ä/ö/ü are stored as $ & # (wire encoding); the web UI
//translates user input before sending. Letters are only displayed for
//serial debug / TEST_ENABLE; the actual rotation is index-based, so
//changing these strings never changes what the physical drum shows.
const String letters[] = {" ", "A", "B", "C", "D", "E", "F", "G", "H", "I", "J", "K", "L", "M", "N", "O", "P", "Q", "R", "S", "T", "U", "V", "W", "X", "Y", "Z", "$", "&", "#", "0", "1", "2", "3", "4", "5", "6", "7", "8", "9", ":", ".", "-", "?", "!"};
Stepper stepper(STEPS, STEPPERPIN1, STEPPERPIN3, STEPPERPIN2, STEPPERPIN4); //stepper setup
bool lastInd1 = false; //store last status of phase
bool lastInd2 = false; //store last status of phase
bool lastInd3 = false; //store last status of phase
bool lastInd4 = false; //store last status of phase
float missedSteps = 0; //cummulate steps <1, to compensate via additional step when reaching >1
int currentlyrotating = 0; // 1 = drum is currently rotating, 0 = drum is standing still
int stepperSpeed = 10; //current speed of stepper, value only for first homing
int eeAddress = 0;   //EEPROM address for calibration offset
int calOffset;       //Offset for calibration in steps, stored in EEPROM, gets read in setup
int receivedNumber = 0;
int i2cAddress;

// Set by the I2C receive handler when an enter-bootloader command arrives;
// the main loop then triggers a watchdog reset (doing the reset from inside
// the Wire ISR is risky — we want the I2C transaction to finish cleanly).
volatile bool pendingBootloader = false;

// When true, the next requestEvent() returns the 8-byte GIT_REV instead of
// the rotation-status byte. Flag set by receiveLetter() on CMD_GET_VERSION,
// cleared after the response is sent so subsequent reads fall back to status.
volatile bool pendingVersionResponse = false;

// Interactive calibration flags (issue #32). Each is set from inside the
// Wire ISR by receiveLetter(); loop() drains the non-response ones and
// requestEvent() drains pendingOffsetResponse. The motor/EEPROM work
// cannot run inside the ISR — EEPROM writes take ~7 ms per 2 bytes and
// stepping blocks for tens of ms per step.
volatile bool    pendingOffsetResponse = false;   // consumed by requestEvent
volatile bool    pendingOffsetWrite    = false;   // loop() persists + updates
volatile int16_t pendingOffsetValue    = 0;
volatile bool    pendingHome           = false;   // loop() re-homes
volatile int8_t  pendingJogSteps       = 0;       // loop() steps + clears

// Health / diagnostics state returned by CMD_GET_STATUS (issue #47).
volatile bool     pendingStatusResponse     = false;  // consumed by requestEvent
uint8_t           savedMcusr                = 0;      // snapshot of MCUSR at boot
uint8_t           lifetimeBrownoutCount     = 0;      // mirror of EEPROM slot 4
uint8_t           lifetimeWatchdogCount     = 0;      // mirror of EEPROM slot 5
uint8_t           badCommandCount           = 0;      // saturating, malformed I2C receives since boot
bool              statusLastHomeFailed      = false;  // set by calibrate() on timeout
bool              statusHallNeverTriggered  = false;  // set by calibrate() when hall never read 0
uint16_t          lastHomingStepCount       = 0;      // steps the last calibrate() took to find hall
uint16_t          uptimeSeconds             = 0;      // saturating; updated from loop()

//sleep globals
//Sleep mode is SLEEP_MODE_IDLE: CPU clock stops, peripheral clocks (including
//TWI) keep running so the unit can still ACK I2C transactions while asleep.
//SLEEP_MODE_PWR_DOWN was tried originally but it clock-gates TWI, which made
//the master see spurious -1 reads whenever a unit happened to be sleeping
//during a poll — see issue #22.
const unsigned long WAIT_TIME = 2000;    //wait time before sleep routine gets executed again in milliseconds
unsigned long previousMillis = 0;       //stores last time sleep was interrupted

//setup
void setup() {
  // Capture MCUSR *before* clearing — it tells us why we last reset
  // (brownout / watchdog / external / power-on / jtag). Kept around for
  // CMD_GET_STATUS byte 1, and used right now to bump the lifetime
  // reset counters in EEPROM. See issue #47.
  savedMcusr = MCUSR;
  MCUSR = 0;
  wdt_disable();

  // Lifetime reset counters: persist across power cycles so a unit with
  // chronic power issues (brownouts) can be diagnosed even if the master
  // only polls once. Saturating at 255 — once we're there the signal is
  // already loud enough.
  lifetimeBrownoutCount = EEPROM.read(EEPROM_ADDR_BROWNOUT_CNT);
  lifetimeWatchdogCount = EEPROM.read(EEPROM_ADDR_WATCHDOG_CNT);
  if (savedMcusr & (1 << BORF) && lifetimeBrownoutCount < 0xFF) {
    lifetimeBrownoutCount++;
    EEPROM.update(EEPROM_ADDR_BROWNOUT_CNT, lifetimeBrownoutCount);
  }
  if (savedMcusr & (1 << WDRF) && lifetimeWatchdogCount < 0xFF) {
    lifetimeWatchdogCount++;
    EEPROM.update(EEPROM_ADDR_WATCHDOG_CNT, lifetimeWatchdogCount);
  }

  // i2c adress switch
  pinMode(ADRESSSW1, INPUT_PULLUP);
  pinMode(ADRESSSW2, INPUT_PULLUP);
  pinMode(ADRESSSW3, INPUT_PULLUP);
  pinMode(ADRESSSW4, INPUT_PULLUP);

  //hall sensor
  pinMode(HALLPIN, INPUT);

  i2cAddress = getaddress(); //get I2C Address and save in variable

#ifdef SERIAL_ENABLE
  //initialize serial
  Serial.begin(BAUDRATE);
  Serial.println("starting unit");
  Serial.print("I2CAddress: ");
  Serial.println(i2cAddress);
#endif

  //I2C function assignment
  Wire.begin(i2cAddress); //i2c address of this unit
  // Enable general-call (I2C broadcast to address 0x00) reception so the
  // master can HOME every unit in a single transaction — see issue #47.
  // Wire.begin() sets TWAR = (addr << 1) and clears TWGCE; set it *after*.
  TWAR |= (1 << TWGCE);
  Wire.onReceive(receiveLetter);//call-function for transfered letter via i2c
  Wire.onRequest(requestEvent); //call-funtion if master requests unit state

  getOffset();     //get calibration offset from EEPROM
  calibrate(true); //home stepper after startup

  //test calibration settings
#ifdef TEST_ENABLE
  int calLetters[10] = {0, 26, 1, 21, 14, 43, 30, 31, 32, 39};
  for (int i = 0; i < 10; i++) {
    int currentCalLetter = calLetters[i];
    rotateToLetter(currentCalLetter);
    delay(5000);
  }
#endif
}

void loop() {
  //If an enter-bootloader command arrived, give Wire a beat to finish any
  //in-flight transaction, then let the watchdog reset us. Twiboot takes over
  //from there and the master can push a new sketch over I2C.
  if (pendingBootloader) {
#ifdef SERIAL_ENABLE
    Serial.println("Rebooting into twiboot via watchdog");
    Serial.flush();
#endif
    delay(10);
    wdt_enable(WDTO_15MS);
    while (true) {}
  }

  // Interactive calibration: drain the flags set by receiveLetter(). Snapshot
  // with interrupts disabled so a second command arriving mid-handler can't
  // interleave. The motor + EEPROM work then runs with interrupts back on so
  // the Wire ISR can still ACK follow-up transactions.
  if (pendingOffsetWrite) {
    noInterrupts();
    int16_t v = pendingOffsetValue;
    pendingOffsetWrite = false;
    interrupts();
    calOffset = v;
    EEPROM.put(eeAddress, calOffset);
#ifdef SERIAL_ENABLE
    Serial.print("CalOffset updated to ");
    Serial.println(calOffset);
#endif
    previousMillis = millis();  // keep awake briefly for follow-up commands
  }
  if (pendingHome) {
    noInterrupts();
    pendingHome = false;
    interrupts();
#ifdef SERIAL_ENABLE
    Serial.println("Home requested");
#endif
    calibrate(true);
    // Park at blank — don't immediately rotate back to the last displayed
    // letter when the main letter-diff check runs below.
    receivedNumber = 0;
    displayedLetter = 0;
    previousMillis = millis();
  }
  if (pendingJogSteps != 0) {
    noInterrupts();
    int8_t steps = pendingJogSteps;
    pendingJogSteps = 0;
    interrupts();
#ifdef SERIAL_ENABLE
    Serial.print("Jog ");
    Serial.println(steps);
#endif
    startMotor();
    stepper.setSpeed(stepperSpeed);
    stepper.step(ROTATIONDIRECTION * (int)steps);
    delay(50);
    stopMotor();
    previousMillis = millis();
  }

  unsigned long currentMillis = millis();

  // Uptime counter for CMD_GET_STATUS (issue #47). Saturating at 18 h 12 min;
  // the master is expected to poll more often than that. Cheap arithmetic,
  // fine to recompute every loop iteration.
  uint32_t secondsSinceBoot = currentMillis / 1000UL;
  uptimeSeconds = (secondsSinceBoot > 0xFFFFUL) ? 0xFFFF : (uint16_t)secondsSinceBoot;

  if (currentMillis - previousMillis >= WAIT_TIME) {
    set_sleep_mode(SLEEP_MODE_IDLE);
    sleep_enable();
#ifdef SERIAL_ENABLE
    digitalWrite (LED_BUILTIN, LOW); // shuts off LED when starting to sleep, for debugging
#endif
    sleep_cpu();
#ifdef SERIAL_ENABLE
    digitalWrite (LED_BUILTIN, HIGH); // turns on LED when waking up, for debugging
#endif
    sleep_disable();
    previousMillis = currentMillis; //reset sleep counter
  }  // end of time to sleep

  //check if new letter was received through i2c
  if (displayedLetter != receivedNumber)
  {
    /*
      #ifdef SERIAL_ENABLE
      Serial.print("Value over serial received: ");
      Serial.print(receivedNumber);
      Serial.print(" Letter: ");
      Serial.print(letters[receivedNumber]);
      Serial.println();
      #endif
    */
    //rotate to new letter
    rotateToLetter(receivedNumber);
  }
}

//rotate to letter
void rotateToLetter(int toLetter) {
  if (lastRotation == 0 || (millis() - lastRotation > OVERHEATINGTIMEOUT * 1000)) {
    lastRotation = millis();
    //get letter position
    int posLetter = -1;
    posLetter = toLetter;
    int posCurrentLetter = -1;
    posCurrentLetter = displayedLetter;
    //int amountLetters = sizeof(letters) / sizeof(String);
#ifdef SERIAL_ENABLE
    Serial.print("go to letter: ");
    Serial.println(letters[toLetter]);
#endif
    //go to letter, but only if available (>-1)
    if (posLetter > -1) { //check if letter exists
      //check if letter is on higher index, then no full rotaion is needed
      if (posLetter >= posCurrentLetter) {
#ifdef SERIAL_ENABLE
        Serial.println("direct");
#endif
        //go directly to next letter, get steps from current letter to target letter
        int diffPosition = posLetter - posCurrentLetter;
        startMotor();
        stepper.setSpeed(stepperSpeed);
        //doing the rotation letterwise
        for (int i = 0; i < diffPosition; i++) {
          float preciseStep = (float)STEPS / (float)AMOUNTFLAPS;
          int roundedStep = (int)preciseStep;
          missedSteps = missedSteps + ((float)preciseStep - (float)roundedStep);
          if (missedSteps > 1) {
            roundedStep = roundedStep + 1;
            missedSteps--;
          }
          stepper.step(ROTATIONDIRECTION * roundedStep);
        }
      }
      else {
        //full rotation is needed, good time for a calibration
#ifdef SERIAL_ENABLE
        Serial.println("full rotation incl. calibration");
#endif
        calibrate(false); //calibrate revolver and do not stop motor
        //startMotor();
        stepper.setSpeed(stepperSpeed);
        for (int i = 0; i < posLetter; i++) {
          float preciseStep = (float)STEPS / (float)AMOUNTFLAPS;
          int roundedStep = (int)preciseStep;
          missedSteps = missedSteps + (float)preciseStep - (float)roundedStep;
          if (missedSteps > 1) {
            roundedStep = roundedStep + 1;
            missedSteps--;
          }
          stepper.step(ROTATIONDIRECTION * roundedStep);
        }
      }
      //store new position
      displayedLetter = toLetter;
      //rotation is done, stop the motor
      delay(100); //important to stop rotation before shutting of the motor to avoid rotation after switching off current
      stopMotor();
    }
    else {
#ifdef SERIAL_ENABLE
      Serial.println("letter unknown, go to space");
#endif
      desiredLetter = 0;
    }
  }
}

void receiveLetter(int numBytes) {
  if (numBytes <= 0) return;

  int firstByte = Wire.read();
  int remaining = numBytes - 1;

  // First byte >= AMOUNTFLAPS is a command opcode, not a letter index.
  if (firstByte >= AMOUNTFLAPS) {
    switch ((uint8_t)firstByte) {
      case CMD_ENTER_BOOTLOADER:
      case CMD_REBOOT:
        // Both trigger a watchdog reset. CMD_ENTER_BOOTLOADER is the
        // semantic "hand off to twiboot so the master can push firmware"
        // (master keeps twiboot alive with continuous pings); CMD_REBOOT
        // is "just restart the sketch" (master does nothing, twiboot
        // times out after ~250 ms, sketch runs). Mechanically identical
        // from the unit's side — only master follow-up behavior differs.
        pendingBootloader = true;
        break;
      case CMD_GET_VERSION:
        pendingVersionResponse = true;
        break;
      case CMD_GET_OFFSET:
        pendingOffsetResponse = true;
        break;
      case CMD_GET_STATUS:
        pendingStatusResponse = true;
        break;
      case CMD_SET_OFFSET:
        if (remaining >= 2) {
          uint8_t lo = (uint8_t)Wire.read();
          uint8_t hi = (uint8_t)Wire.read();
          remaining -= 2;
          pendingOffsetValue = (int16_t)((uint16_t)lo | ((uint16_t)hi << 8));
          pendingOffsetWrite = true;
        } else if (badCommandCount < 0xFF) {
          badCommandCount++;
        }
        break;
      case CMD_JOG:
        if (remaining >= 1) {
          pendingJogSteps = (int8_t)Wire.read();
          remaining--;
        } else if (badCommandCount < 0xFF) {
          badCommandCount++;
        }
        break;
      case CMD_HOME:
        pendingHome = true;
        break;
      default:
        if (badCommandCount < 0xFF) badCommandCount++;
        break;  // unknown opcode -> ignore
    }
    while (remaining-- > 0) Wire.read();  // drain any extra args
    return;
  }

  // Legacy letter+speed protocol is exactly 2 bytes. Anything else is a
  // probe (the master's bootloader-detection write hits this code path)
  // or a malformed command — drain and ignore so we don't accidentally
  // rotate the drum to a random letter when probed. Single-byte empty
  // transmissions are the master's standard bus-scan probe, not errors.
  if (numBytes != 2) {
    if (numBytes > 2 && badCommandCount < 0xFF) badCommandCount++;
    while (remaining-- > 0) Wire.read();
    return;
  }

  receivedNumber = firstByte;
  stepperSpeed   = Wire.read();
}

void requestEvent() {
  if (pendingVersionResponse) {
    // Send exactly 8 bytes: GIT_REV, null-padded. Master reads 8 and compares.
    uint8_t buf[8] = {0};
    for (uint8_t i = 0; i < 8 && GIT_REV[i] != '\0'; i++) buf[i] = GIT_REV[i];
    Wire.write(buf, 8);
    pendingVersionResponse = false;
    return;
  }
  if (pendingOffsetResponse) {
    // Send exactly 2 bytes: int16 calOffset, little-endian.
    uint16_t raw = (uint16_t)calOffset;
    uint8_t buf[2] = { (uint8_t)(raw & 0xFF), (uint8_t)((raw >> 8) & 0xFF) };
    Wire.write(buf, 2);
    pendingOffsetResponse = false;
    return;
  }
  if (pendingStatusResponse) {
    // Issue #47. 8-byte health/diag payload. Master parses into UnitStatus;
    // old masters that don't know CMD_GET_STATUS never send it, so this
    // branch won't fire for them.
    //
    //   byte 0   status flag bitfield
    //             bit 0  currentlyrotating
    //             bit 1  last home FAILED (hit 3*STEPS without marker)
    //             bit 2  hall never triggered during last home
    //             bit 3  reserved (stuck drum, future)
    //             bits 4-7 reserved
    //   byte 1   savedMcusr — current-boot reset-cause snapshot
    //   byte 2   lifetime brownout reset count (EEPROM, saturating)
    //   byte 3   lifetime watchdog reset count (EEPROM, saturating)
    //   byte 4-5 uptime in seconds (uint16 big-endian, saturating)
    //   byte 6   bad I2C command count since boot (saturating)
    //   byte 7   last homing step count / 16 (saturating uint8)
    uint8_t flags = 0;
    if (currentlyrotating)          flags |= (1 << 0);
    if (statusLastHomeFailed)       flags |= (1 << 1);
    if (statusHallNeverTriggered)   flags |= (1 << 2);
    uint8_t lastHomeScaled = (lastHomingStepCount >> 4);
    if (lastHomeScaled > 0xFF) lastHomeScaled = 0xFF;
    uint8_t buf[8] = {
      flags,
      savedMcusr,
      lifetimeBrownoutCount,
      lifetimeWatchdogCount,
      (uint8_t)((uptimeSeconds >> 8) & 0xFF),
      (uint8_t)(uptimeSeconds & 0xFF),
      badCommandCount,
      lastHomeScaled,
    };
    Wire.write(buf, 8);
    pendingStatusResponse = false;
    return;
  }
  Wire.write(currentlyrotating); //send unit status to master
}

//Returns the I2C address of the unit. EEPROM takes precedence (set by the
//position wizard, once implemented) so the physical DIP switches don't need
//to be unique after first setup; empty/invalid EEPROM falls back to
//I2C_ADDRESS_BASE + DIP.
int getaddress() {
  uint8_t magic = EEPROM.read(EEPROM_ADDR_ID_MAGIC);
  if (magic == EEPROM_ID_MAGIC_VALUE) {
    uint8_t stored = EEPROM.read(EEPROM_ADDR_I2C_ADDR);
    //Reject obviously bad values. Address 0 is reserved general-call, 127 is
    //reserved too; anything else in 1..126 is plausible.
    if (stored >= 1 && stored <= 126) {
      return stored;
    }
  }
  int dipValue = !digitalRead(ADRESSSW4) + (!digitalRead(ADRESSSW3) * 2) + (!digitalRead(ADRESSSW2) * 4) + (!digitalRead(ADRESSSW1) * 8);
  return I2C_ADDRESS_BASE + dipValue;
}

//gets magnet sensor offset from EEPROM in steps
void getOffset() {
  EEPROM.get(eeAddress, calOffset);
#ifdef SERIAL_ENABLE
  Serial.print("CalOffset from EEPROM: ");
  Serial.print(calOffset);
  Serial.println();
#endif
}

//doing a calibration of the revolver using the hall sensor
int calibrate(bool initialCalibration) {
#ifdef SERIAL_ENABLE
  Serial.println("calibrate revolver");
#endif
  currentlyrotating = 1; //set active state to active
  bool reachedMarker = false;
  // Track whether the hall sensor ever read 0 (magnet detected) during this
  // homing attempt. Stays true only if hall was 0 from step 0 OR we stepped
  // through to find it. If we time out with hall stuck at 1, the status bit
  // tells the master "magnet fell off / bad KY-003 / wiring issue".
  // Issue #47.
  bool hallSawMagnet = false;
  stepper.setSpeed(stepperSpeed);
  int i = 0;
  while (!reachedMarker) {
    int currentHallValue = digitalRead(HALLPIN);
    if (currentHallValue == 0) {
      hallSawMagnet = true;
    }
    if (currentHallValue == 1 && i == 0) { //already in zero position move out a bit and do the calibration {
      //not reached yet
      i = 50;
      stepper.step(ROTATIONDIRECTION * 50); //move 50 steps to get out of scope of hall
    }
    else if (currentHallValue == 1) {
      //not reached yet
      stepper.step(ROTATIONDIRECTION * 1);
    }
    else {
      //reached marker, go to calibrated offset position
      reachedMarker = true;
      stepper.step(ROTATIONDIRECTION * calOffset);
      displayedLetter = 0;
      missedSteps = 0;
#ifdef SERIAL_ENABLE
      Serial.println("revolver calibrated");
#endif
      statusLastHomeFailed = false;
      statusHallNeverTriggered = !hallSawMagnet;
      lastHomingStepCount = (uint16_t)i;
      //Only stop motor for initial calibration
      if (initialCalibration) {
        stopMotor();
      }
      return i;
    }
    if (i > 3 * STEPS) {
      //seems that there is a problem with the marker or the sensor. turn of the motor to avoid overheating.
      displayedLetter = 0;
      desiredLetter = 0;
      reachedMarker = true;
#ifdef SERIAL_ENABLE
      Serial.println("calibration revolver failed");
#endif
      statusLastHomeFailed = true;
      statusHallNeverTriggered = !hallSawMagnet;
      lastHomingStepCount = (uint16_t)i;
      stopMotor();
      return -1;
    }
    i++;
  }
  return i;
}

//switching off the motor driver
void stopMotor() {
  lastInd1 = digitalRead(STEPPERPIN1);
  lastInd2 = digitalRead(STEPPERPIN2);
  lastInd3 = digitalRead(STEPPERPIN3);
  lastInd4 = digitalRead(STEPPERPIN4);

  digitalWrite(STEPPERPIN1, LOW);
  digitalWrite(STEPPERPIN2, LOW);
  digitalWrite(STEPPERPIN3, LOW);
  digitalWrite(STEPPERPIN4, LOW);
#ifdef SERIAL_ENABLE
  Serial.println("Motor Stop");
#endif
  currentlyrotating = 0; //set active state to not active
  delay(100);
}

void startMotor() {
#ifdef SERIAL_ENABLE
  Serial.println("Motor Start");
#endif
  currentlyrotating = 1; //set active state to active
  digitalWrite(STEPPERPIN1, lastInd1);
  digitalWrite(STEPPERPIN2, lastInd2);
  digitalWrite(STEPPERPIN3, lastInd3);
  digitalWrite(STEPPERPIN4, lastInd4);
}
