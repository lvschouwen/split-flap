/*********
  Split Flap Arduino Nano Unit
*********/

//#define SERIAL_ENABLE // uncomment for serial debug communication
//#define TEST_ENABLE   // uncomment for Test mode. Rotates through a few character to make sure unit is working. These characters should be displayed in the correct order: " ", "Z", "A", "U", "N", "?", "0", "1", "2", "9"

#include <Arduino.h>
#include <Wire.h>
#include <Stepper.h>
#include <EEPROM.h>
#include <avr/sleep.h>
#include <avr/wdt.h>
#include "BuildVersion.h"  // GIT_REV, generated by build_version.py
#include "UnitEeprom.h"    // pure EEPROM layout + block integrity (#406)
#include "UnitLifetime.h"  // pure GET_LIFETIME reply encode (#406/#407)
#include "UnitWireContract.h"  // pure core read/write wire formats (#405)
#include "UnitOdometer.h"  // pure revolution-odometer logic (#231)
#include "UnitDrift.h"     // pure drift-detection logic (#263/#264)
#include "UnitIdleHall.h"  // pure idle hall-consistency logic (#268)
#include "UnitSelfTest.h"  // pure self-test result + wire encode (#265)
#include "UnitVitals.h"    // pure supply-Vcc/ram/cmd-pos diag packet (#306)
#include "UnitExtDiag.h"   // pure ext-diag reply encode (#365; AVR glue below)
#include "BootHomePolicy.h"  // pure staggered boot-home decision (#309)
// Single source of truth for the master<->unit I2C contract (opcodes, address
// base, alphabet, flap count), shared with firmware/v1/ESPMaster (#149).
#include "SplitFlapProtocol.h"

// Pins of I2C adress switch
#define ADRESSSW1 6
#define ADRESSSW2 5
#define ADRESSSW3 4
#define ADRESSSW4 3

// I2C address base (SFP_I2C_ADDRESS_BASE) is defined in SplitFlapProtocol.h.

// EEPROM map, block checksums and the odometer ring geometry all live in
// UnitEeprom.h / UnitOdometer.h — the layout is a natively tested pure
// header, this file is only its read/write glue. Every block is checksummed
// and every failure degrades to a safe default (identity -> DIP address,
// calibration -> 0, health -> zeros); the ring sits last so future scalars
// never move it again.

// I2C "receive" namespace: the first byte is a letter index (0..AMOUNTFLAPS-1)
// for normal display commands, or a command opcode (>= AMOUNTFLAPS) for
// control commands. The opcodes (SFP_CMD_*) and their semantic bands are
// defined once in SplitFlapProtocol.h and shared with the master (#149).

//constants stepper
#define STEPPERPIN1 11
#define STEPPERPIN2 10
#define STEPPERPIN3 9
#define STEPPERPIN4 8
#define STEPS 2038 //28BYJ-48 stepper, number of steps
// The protocol's SET_OFFSET bound is defined as one revolution of THIS drum;
// if the stepper ever changes, SplitFlapProtocol.h must change with it (#171).
static_assert(STEPS == SFP_OFFSET_LIMIT_STEPS,
              "SFP_OFFSET_LIMIT_STEPS must equal the drum's steps per revolution");
#define HALLPIN 7 //Pin of hall sensor
#define AMOUNTFLAPS SFP_FLAP_AMOUNT  // derived from SFP_ALPHABET (SplitFlapProtocol.h, #149)

//constants others
#define BAUDRATE 115200
#define HOMING_RPM 10 //fixed speed for homing (issue #108). Homing used to run at whatever speed the last message used — a fast message followed by a HOME homed fast, risking overshooting the hall window and inconsistent zero points.
#define ROTATIONDIRECTION 1 //-1 for reverse direction (swap if the drum rotates the wrong way)
#define OVERHEATINGTIMEOUT 2 //timeout in seconds to avoid overheating of stepper. After starting rotation, the counter will start. Stepper won't move again until timeout is passed
unsigned long lastRotation = 0;

//globals
//displayedLetter is written from loop context (rotateToLetter/calibrate) and
//read by requestEvent() in the TWI ISR for SFP_CMD_GET_LETTER — volatile for the
//same LTO-visibility reason as the pending* flags. Values fit in one byte,
//so the non-atomic int access is harmless (#106).
volatile int displayedLetter = 0; //currently shown letter
//Sourced from SFP_ALPHABET (SplitFlapProtocol.h, #149) so master, unit and
//script.js can never drift. ä/ö/ü are wire-encoded as $ & #; the web UI
//translates user input before sending. Letters are only used for serial
//debug prints; the actual rotation is index-based, so changing this string
//never changes what the physical drum shows. Flash-resident: the previous
//Arduino String array burned ~350 bytes of the 2 KB SRAM (issue #109).
const char LETTER_CHARS[] PROGMEM = SFP_ALPHABET;
static_assert(sizeof(LETTER_CHARS) - 1 == AMOUNTFLAPS, "LETTER_CHARS must have exactly AMOUNTFLAPS entries");
Stepper stepper(STEPS, STEPPERPIN1, STEPPERPIN3, STEPPERPIN2, STEPPERPIN4); //stepper setup
bool lastInd1 = false; //store last status of phase
bool lastInd2 = false; //store last status of phase
bool lastInd3 = false; //store last status of phase
bool lastInd4 = false; //store last status of phase
float missedSteps = 0; //cummulate steps <1, to compensate via additional step when reaching >1
// STEPS/AMOUNTFLAPS is non-integer (2038/45 ≈ 45.29). Precompute the whole and
// fractional parts once — the float division used to run every step inside
// rotateToLetter, and float division is slow on AVR. See stepFlaps() (#136).
static const int   STEPS_PER_FLAP_WHOLE = STEPS / AMOUNTFLAPS;
static const float STEPS_PER_FLAP_FRAC  = (float)STEPS / (float)AMOUNTFLAPS - (float)STEPS_PER_FLAP_WHOLE;
// volatile: read inside the Wire ISR (requestEvent() status/idle byte the
// master polls) and written all over loop() (startMotor/stopMotor/calibrate
// and the overheat-gate early return in rotateToLetter). Without it, LTO can
// serve the ISR a stale 0 and the master's waitForDisplayToStop() concludes
// idle prematurely (#143). Value is 0/1, so non-atomic 16-bit access is
// harmless — same rationale as receivedNumber/stepperSpeed below.
volatile int currentlyrotating = 0; // 1 = drum is currently rotating, 0 = drum is standing still
// receivedNumber and stepperSpeed are written from the Wire ISR
// (receiveLetter) and read in loop()/rotateToLetter() — volatile for the
// same reason as the pending* flags (LTO may otherwise cache them). Values
// fit in the low byte, so the non-atomic 16-bit access is harmless.
volatile int stepperSpeed = 10; //current speed of stepper, from the last letter command; default only matters for a jog before any message (homing uses HOMING_RPM)
// Read by requestEvent() in the TWI ISR (SFP_CMD_GET_OFFSET reply) — volatile
// for LTO visibility like every other ISR-shared field here (#143/#173).
// EEPROM.get/put's templates reject volatile refs: go through a non-volatile
// local shadow at those two sites (getOffset(), the pendingOffsetWrite drain).
volatile int calOffset; //Offset for calibration in steps, stored in EEPROM, gets read in setup
volatile int receivedNumber = 0;
int i2cAddress;
// True when getaddress() returned the EEPROM-provisioned address instead of
// the DIP-derived one. Surfaced as GET_STATUS flags bit 4 (#215): twiboot only
// listens on the DIP-derived address, so the master needs to know a unit may
// be unreachable for over-I2C reflash. Written once in setup() before the
// Wire handlers register, then only read by the ISR — non-volatile is fine
// for the same reason as savedMcusr.
bool addressFromEeprom = false;

// Set by the I2C receive handler when an enter-bootloader command arrives;
// the main loop then triggers a watchdog reset (doing the reset from inside
// the Wire ISR is risky — we want the I2C transaction to finish cleanly).
volatile bool pendingBootloader = false;

// When true, the next requestEvent() returns the 8-byte GIT_REV instead of
// the rotation-status byte. Flag set by receiveLetter() on SFP_CMD_GET_VERSION,
// cleared after the response is sent so subsequent reads fall back to status.
volatile bool pendingVersionResponse = false;

// Interactive calibration flags (issue #32). Each is set from inside the
// Wire ISR by receiveLetter(); loop() drains the non-response ones and
// requestEvent() drains pendingOffsetResponse. The motor/EEPROM work
// cannot run inside the ISR — EEPROM writes take ~7 ms per 2 bytes and
// stepping blocks for tens of ms per step.
volatile bool    pendingOffsetResponse = false;   // consumed by requestEvent
volatile bool    pendingOffsetWrite    = false;   // loop() persists + updates
volatile int16_t pendingOffsetValue    = 0;
volatile bool    pendingHome           = false;   // loop() re-homes
volatile int8_t  pendingJogSteps       = 0;       // loop() steps + clears

// Provisioning flags (issue #56). EEPROM writes and reboots can't run from
// the Wire ISR — defer to loop() like every other mutation. identifyStartMs
// is a plain unsigned long because it's only written by loop() once the
// pendingIdentify flag is consumed; 0 means "not currently identifying".
volatile bool    pendingSetAddress      = false;
volatile uint8_t pendingAddressValue    = 0;
volatile bool    pendingClearAddress    = false;
volatile bool    pendingIdentify        = false;
unsigned long    identifyStartMs        = 0;

// Feature-gate write (#409), the same ISR-sets/loop-drains shape as every
// other EEPROM mutation. The gate byte decides whether the motion changes
// #407 shipped dormant actually run, so turning one on costs a wire write
// instead of a second fleet reflash.
volatile bool    pendingGatesWrite      = false;
volatile uint8_t pendingGatesValue      = 0;

// Health / diagnostics state returned by SFP_CMD_GET_STATUS (issue #47).
volatile bool     pendingStatusResponse     = false;  // consumed by requestEvent
volatile bool     pendingLetterResponse     = false;  // consumed by requestEvent (#106)

// Drum drift tracking (#263/#264). `drift` is loop-context only — every
// step happens in loop and UnitMotion.ino's stepCounted()/hall watch fold
// into it. The ISR-visible interface is the two pre-encoded reply buffers
// below: driftRefreshReplyBuffers() (UnitMotion.ino) re-encodes them under
// noInterrupts() so requestEvent() can never stream a torn reply (#96
// class); it runs once per loop() pass plus at the state transitions the
// loop can't see (self-test start). Initialised in setup() BEFORE the Wire
// handlers register — same ordering rule as getOffset() (#173).
DriftState        drift                     = {0, false, 0, 0, false};
volatile uint8_t  diagReplyBuf[DRIFT_REPLY_LEN]        = {0};
volatile bool     pendingDiagResponse       = false;  // consumed by requestEvent
unsigned long     lastAutoRehomeMs          = 0;      // 0 = never auto re-homed
// Idle hall consistency check (#268), loop-context only — it samples a pin
// and arms the drift re-home above, so nothing here crosses into the ISR.
// Runs only with UNIT_GATE_IDLE_HALL_CHECK set; ships dormant (#407).
IdleHallCheck     idleHall                  = {0, IDLE_HALL_EXPECT_UNKNOWN};
unsigned long     idleHallLastSampleMs      = 0;
// Consecutive re-homes this check armed that measured no drift deviation —
// proof the window model is wrong rather than the belief (UnitIdleHall.h).
// Since-boot only; a power cycle is a free retry.
uint8_t           idleHallFutileRehomes     = 0;
bool              idleHallArmedRehome       = false;
// At most one drift-triggered re-home per minute: a mechanically failing
// unit (loose magnet, slipping drum) must not spend its life homing —
// driftEvents keeps counting so the master still sees it.
#define DRIFT_REHOME_COOLDOWN_MS 60000UL

// On-demand self-test (#265). Result lives in loop context; the encoded
// mirror rides selfTestReplyBuf like the diag reply above.
// Field defaults live in the struct (#404) — brace-init here would break on
// AVR's C++11, where a default member initialiser makes the class a
// non-aggregate, and would silently omit any field added later.
SelfTestResult    selfTest;
volatile uint8_t  selfTestReplyBuf[SELFTEST_REPLY_LEN] = {0};
volatile bool     pendingSelfTest           = false;  // loop() runs the test
volatile bool     pendingSelfTestResponse   = false;  // consumed by requestEvent

// Supply-Vcc / free-RAM / commanded-position diagnostics (#306). vccMin and
// freeRamMin are since-boot minima held in loop-context RAM (a brownout/reboot
// resets them — the persisted lifetimeBrownoutCount records that it happened).
// vitalsRefreshReplyBuffer() re-encodes the ISR-visible mirror each loop pass
// under noInterrupts(), exactly like the diag/self-test buffers above, so
// requestEvent() streams it verbatim and never sees a torn packet (#96 class).
uint16_t          vitalsVccNow              = 0;       // last sampled rail (mV)
uint16_t          vitalsVccMin              = 0xFFFF;  // since-boot min (sentinel high)
uint16_t          vitalsFreeRamMin          = 0xFFFF;  // since-boot min free SRAM
unsigned long     vitalsLastSampleMs        = 0;       // idle-sample throttle
volatile uint8_t  vitalsReplyBuf[VITALS_REPLY_LEN] = {0};
volatile bool     pendingVitalsResponse     = false;  // consumed by requestEvent

// Extended per-move diagnostics (#365). Measured in loop context (UnitMotion.ino
// hooks: step-excess in calibrate() #370, per-move Vcc sag #371, hall-edges-per-
// rev #372, duty window #373, stall #374). refreshExtDiagReply() re-encodes the
// ISR-visible mirror each loop pass under noInterrupts() — same #96-class torn-
// read discipline as the vitals/diag buffers above. Only extDiagReplyBuf and
// pendingExtDiagResponse cross into the TWI ISR; the raw counters are loop-only.
volatile bool     pendingExtDiagResponse    = false;  // consumed by requestEvent
volatile uint8_t  extDiagReplyBuf[EXT_DIAG_REPLY_LEN] = {0};
uint16_t          extStepExcessLast         = 0;      // #370 last home: actual-expected steps
uint16_t          extStepExcessMax          = 0;      // #370 worst-seen since boot
uint16_t          extVccSagLastMove         = 0xFFFF; // #371 min loaded Vcc this move (sentinel high)
// Pre-first-revolution there is no real sample yet; report 1 (the benign/
// healthy sentinel). The master treats 0 as "no completed rev measured" and
// only flags >1 (#418) — this default keeps a fresh boot unambiguous either
// way, and a completed rev always overwrites it with the true count.
uint8_t           extHallEdgesLastRev       = 1;      // #372 entering edges in last completed rev
uint16_t          extHallEdgesThisRev       = 0;      // #372 running count within the current rev
uint16_t          extDutyWindow             = 0;      // #373 decaying rolling ~60 s move count
uint8_t           extStatusBits             = 0;      // #374 bit0 = last-move stall

// Revolution odometer (#231). `odometer` is loop-context only (every step
// happens in loop; stepCounted() folds them in). The ISR-visible mirror is
// what SFP_CMD_GET_ODOMETER replies from — 4 bytes, so loop-side updates
// must be wrapped in noInterrupts()/interrupts() or the TWI ISR can read a
// torn half-written value (#96 class). Persist cadence + ring policy live
// in UnitOdometer.h; lastPersistedRevs tracks the last ring write.
OdometerState     odometer                  = {0, 0};
volatile uint32_t odometerRevolutions       = 0;      // ISR-read mirror of odometer.revolutions
uint32_t          lastPersistedRevs         = 0;
volatile bool     pendingOdometerResponse   = false;  // consumed by requestEvent
volatile bool     pendingOdometerReset      = false;  // loop() zeroes counter + ring
uint8_t           savedMcusr                = 0;      // snapshot of MCUSR at boot
// ISR-facing mirrors of the two counters GET_STATUS reports. Set once in
// setup() before the Wire handlers register and never written again, which
// is why they need no volatile (same rationale as savedMcusr).
uint8_t           lifetimeBrownoutCount     = 0;
uint8_t           lifetimeWatchdogCount     = 0;

// Lifetime health record (#406) — what the unit remembers about its own
// decline across power cycles: the two reset counters above, failed homings,
// the worst step-excess it has ever seen, and its first/last self-test
// measurements. Loop-context only; the ISR reads the pre-encoded reply
// buffer, never this struct. Persisted by persistLifetimeHealth() on the
// events that move it — never per move.
UnitLifetimeHealth lifetime;
// ISR-visible mirror of the GET_LIFETIME reply, re-encoded by
// refreshLifetimeReply() whenever the record is persisted — same #96-class
// torn-read discipline as the diag/vitals/ext-diag buffers.
volatile bool     pendingLifetimeResponse   = false;  // consumed by requestEvent
volatile uint8_t  lifetimeReplyBuf[LIFETIME_REPLY_LEN] = {0};
// Incremented from BOTH the TWI ISR (receiveLetter) and loop() (the invalid-
// address branch of the pendingSetAddress drain) and read back in the ISR's
// status reply — volatile for LTO visibility, and the loop-side RMW must be
// wrapped in noInterrupts()/interrupts() or a concurrent ISR increment is
// lost (#172). Single-byte, so the ISR-side increments are atomic as-is.
volatile uint8_t  badCommandCount           = 0;      // saturating, malformed I2C receives since boot
// The four status fields below are written from loop context (calibrate()/
// loop()) and read by requestEvent() in the TWI ISR — volatile, and the
// 16-bit ones are written under noInterrupts() so the ISR can't see a
// torn half-written value (#96, same class as the calOffset fix).
volatile bool     statusLastHomeFailed      = false;  // set by calibrate() on timeout
volatile bool     statusHallNeverTriggered  = false;  // set by calibrate() when hall never read 0
volatile uint16_t lastHomingStepCount       = 0;      // steps the last calibrate() took to find hall
volatile uint16_t uptimeSeconds             = 0;      // saturating; updated from loop()

// Staggered boot homing (#309). The unit no longer homes in setup() — it boots
// UNHOMED/blank and homes on the first trigger, so a whole row's steppers don't
// spike the shared rail at once (root cause of the #305 verify-boot brownout).
// `homed` is set by calibrate() on success and read in the TWI ISR (status
// flags bit 5 -> master hs2), so it is volatile. `masterEverContacted` is set
// in receiveLetter() (ISR) on any receive and read in loop(); single byte, so
// atomic. bootHomeAttempted gates the self-home to a single try (a failing hall
// must not re-home every loop and cook the motor); bootHomeJitterMs is seeded
// once in setup(). Decision table is pure in BootHomePolicy.h.
volatile bool     homed                     = false;  // homed at least once since boot
volatile bool     masterEverContacted       = false;  // any I2C receive since boot
bool              bootHomeAttempted         = false;  // self-home tried (loop ctx)
uint16_t          bootHomeJitterMs          = 0;      // 0..BOOT_HOME_JITTER_MAX_MS
// Rate-limit the trigger-2 home (a letter command while UNHOMED, #309): a unit
// whose hall never fires would otherwise re-seek a full revolution on EVERY
// letter (calibrate() has no overheat gate — it would cook the motor). After a
// homing attempt while unhomed, hold off this long before the next one; a
// successful home sets `homed` and disables the path entirely. Loop-context.
unsigned long     lastUnhomedCalibrateMs    = 0;      // 0 = never attempted
#define UNHOMED_CALIBRATE_COOLDOWN_MS 30000UL
// Status flag bit surfaced to the master (mirrors UnitHealth.h UNIT_FLAG_HOMED).
#define UNIT_STATUS_FLAG_HOMED (1 << 5)

//sleep globals
//Sleep mode is SLEEP_MODE_IDLE: CPU clock stops, peripheral clocks (including
//TWI) keep running so the unit can still ACK I2C transactions while asleep.
//SLEEP_MODE_PWR_DOWN was tried originally but it clock-gates TWI, which made
//the master see spurious -1 reads whenever a unit happened to be sleeping
//during a poll — see issue #22.
const unsigned long WAIT_TIME = 2000;    //wait time before sleep routine gets executed again in milliseconds
unsigned long previousMillis = 0;       //stores last time sleep was interrupted

// Write the lifetime-health block back under its checksum (#406). Called only
// on the events that actually move it — a reset cause at boot, a failed
// homing, a new step-excess record, a completed self-test — never per move.
// EEPROM.update means an unchanged byte costs nothing.
void persistLifetimeHealth() {
  uint8_t block[EE_HEALTH_BLOCK_LEN];
  unitEeHealthEncode(lifetime, block);
  for (uint8_t i = 0; i < EE_HEALTH_BLOCK_LEN; i++) {
    EEPROM.update(EE_HEALTH_BASE + i, block[i]);
  }
  refreshLifetimeReply();
}

// Re-encode the ISR-visible GET_LIFETIME reply. Driven off the persist path
// rather than polled from loop(): the record only ever changes on the events
// that persist it, so there is nothing to re-encode in between.
void refreshLifetimeReply() {
  UnitLifetimeFacts f;
  f.layoutVersion            = UNIT_EE_LAYOUT_VERSION;
  f.homeFailedCount          = lifetime.homeFailedCount;
  f.featureGates             = lifetime.featureGates;
  f.stepExcessLifetimeMax    = lifetime.stepExcessLifetimeMax;
  f.selfTestFirstHallWindow  = lifetime.selfTestFirstHallWindow;
  f.selfTestFirstStepsPerRev = lifetime.selfTestFirstStepsPerRev;
  f.selfTestLastHallWindow   = lifetime.selfTestLastHallWindow;
  f.selfTestLastStepsPerRev  = lifetime.selfTestLastStepsPerRev;
  uint8_t buf[LIFETIME_REPLY_LEN];
  lifetimeEncodeReply(f, buf);
  noInterrupts();
  for (uint8_t i = 0; i < LIFETIME_REPLY_LEN; i++) lifetimeReplyBuf[i] = buf[i];
  interrupts();
}

//setup
void setup() {
  // Capture MCUSR *before* clearing — it tells us why we last reset
  // (brownout / watchdog / external / power-on / jtag). Kept around for
  // SFP_CMD_GET_STATUS byte 1, and used right now to bump the lifetime
  // reset counters in EEPROM. See issue #47.
  savedMcusr = MCUSR;
  MCUSR = 0;
  wdt_disable();

  // Lifetime reset counters: persist across power cycles so a unit with
  // chronic power issues (brownouts) can be diagnosed even if the master
  // only polls once. Saturating at 255 — once we're there the signal is
  // already loud enough.
  //
  // Fresh/erased AVR EEPROM reads back 0xFF on every byte, which would
  // masquerade as 255 saturated resets — and the saturating guard below then
  // pins them there forever (every freshly-provisioned unit reported 255/255,
  // #139). A dedicated magic byte marks the counter block as initialised; when
  // it's absent we zero the counters once and stamp the magic.
  // Day-0 EEPROM initialisation (#406). One version byte does what three
  // magics used to: anything that is not the current layout is blank and gets
  // written fresh. The version byte is stamped LAST, so a power loss mid-init
  // simply re-runs it on the next boot rather than leaving a half-written
  // layout marked valid.
  //
  // The odometer ring is deliberately NOT written here. Erased slots read
  // 0xFFFFFFFF and every one of them is rejected unconditionally by the
  // checksummed boot scan, so a blank ring already recovers as 0 — zeroing
  // 640 bytes at first boot would spend endurance to reach the same answer.
  if (unitEeIsBlank(EEPROM.read(EE_LAYOUT_VERSION))) {
    uint8_t block[EE_HEALTH_BLOCK_LEN];
    unitEeCalEncode(0, block);
    for (uint8_t i = 0; i < EE_CAL_BLOCK_LEN; i++) {
      EEPROM.update(EE_CAL_OFFSET + i, block[i]);
    }
    UnitLifetimeHealth fresh = UnitLifetimeHealth();
    unitEeHealthEncode(fresh, block);
    for (uint8_t i = 0; i < EE_HEALTH_BLOCK_LEN; i++) {
      EEPROM.update(EE_HEALTH_BASE + i, block[i]);
    }
    unitEeIdentityClear(block);  // no burned address -> DIP, the safe default
    for (uint8_t i = EE_ID_BLOCK_LEN; i > 1; i--) {
      EEPROM.update(EE_LAYOUT_VERSION + (i - 1), block[i - 1]);
    }
    EEPROM.update(EE_LAYOUT_VERSION, block[0]);  // version LAST
  }

  // Lifetime health: the reset counters plus the unit's own record of its
  // mechanical decline, all under one checksum. A blank or torn block decodes
  // to zeros — adopting the raw bytes is what made every freshly provisioned
  // unit report 255/255 saturated resets on erased EEPROM (#139), and the
  // saturating guard then pinned them there forever.
  {
    uint8_t block[EE_HEALTH_BLOCK_LEN];
    for (uint8_t i = 0; i < EE_HEALTH_BLOCK_LEN; i++) {
      block[i] = EEPROM.read(EE_HEALTH_BASE + i);
    }
    bool healthValid = unitEeHealthDecode(block, lifetime);
    bool bumped = false;
    if (savedMcusr & (1 << BORF)) {
      unitEeBumpSaturating(lifetime.brownoutCount);
      bumped = true;
    }
    if (savedMcusr & (1 << WDRF)) {
      unitEeBumpSaturating(lifetime.watchdogCount);
      bumped = true;
    }
    // Rewrite an unreadable block even when nothing was bumped, so a unit
    // that never resets still ends up with a valid block instead of
    // re-zeroing on every boot.
    if (bumped || !healthValid) persistLifetimeHealth();
    lifetimeBrownoutCount = lifetime.brownoutCount;
    lifetimeWatchdogCount = lifetime.watchdogCount;
  }

  // Revolution odometer (#231): recover the count from the EEPROM ring.
  // Folded slot by slot — a 128-slot read-at-once would need a 512-byte stack
  // buffer on a 2 KB Nano. Runs before the Wire handlers register: the ISR
  // mirror below must be coherent before a master can query it (same ordering
  // rule as getOffset(), #173).
  {
    OdometerBootScan scan;
    odometerBootScanInit(scan);
    for (uint8_t s = 0; s < ODO_RING_SLOTS; s++) {
      int at = EE_ODO_RING_BASE + (int)odometerSlotOffset(s);
      uint32_t value;
      EEPROM.get(at, value);
      odometerBootScanSlot(scan, value, EEPROM.read(at + 4));
    }
    odometer.revolutions = odometerBootScanResult(scan);
  }
  lastPersistedRevs = odometer.revolutions;
  odometerRevolutions = odometer.revolutions;

  // i2c adress switch
  pinMode(ADRESSSW1, INPUT_PULLUP);
  pinMode(ADRESSSW2, INPUT_PULLUP);
  pinMode(ADRESSSW3, INPUT_PULLUP);
  pinMode(ADRESSSW4, INPUT_PULLUP);

  //hall sensor
  pinMode(HALLPIN, INPUT);

  // Onboard LED drives SFP_CMD_IDENTIFY blink (issue #56). Without OUTPUT mode
  // digitalWrite only toggles the pull-up, so pre-existing SERIAL_ENABLE
  // debug LED uses were effectively no-ops. Harmless to set unconditionally.
  pinMode(LED_BUILTIN, OUTPUT);
  digitalWrite(LED_BUILTIN, LOW);

  i2cAddress = getaddress(); //get I2C Address and save in variable

#ifdef SERIAL_ENABLE
  //initialize serial
  Serial.begin(BAUDRATE);
  Serial.println("starting unit");
  Serial.print("I2CAddress: ");
  Serial.println(i2cAddress);
#endif

  // Read the calibration offset BEFORE the Wire handlers go live (#173):
  // EEPROM.get into the 2-byte calOffset is not atomic, and requestEvent()
  // reads calOffset from the TWI ISR — registering first left a boot-time
  // window where a GET_OFFSET reply could see a torn half-written value
  // (same class as the #96/#143 fixes). All later writes happen in loop()
  // under noInterrupts(), so this ordering closes the only unguarded one.
  getOffset();

  // Pre-encode the diag/self-test reply buffers before the Wire handlers
  // register (#173 ordering rule): a boot-time GET_DIAG must stream a
  // coherent "position unknown" reply, never uninitialised bytes.
  driftRefreshReplyBuffers();
  // Same for the vitals reply (#306): take a boot Vcc/RAM sample and publish
  // it so a GET_VITALS right after boot streams a real rail, not zeroes.
  vitalsSample(false);
  vitalsRefreshReplyBuffer();
  // Ext-diag reply (#365): publish a coherent all-zero/sentinel packet before
  // the Wire handlers register, same #173 ordering rule as the buffers above.
  refreshExtDiagReply();
  // Lifetime reply (#406): same #173 ordering rule. persistLifetimeHealth()
  // above only runs when the record actually moved, so publish unconditionally
  // here — otherwise a GET_LIFETIME before the first persist would stream an
  // all-zero buffer whose checksum byte is 0, which the master rejects as
  // padding rather than reading as a genuinely fresh unit.
  refreshLifetimeReply();

  //I2C function assignment
  Wire.begin(i2cAddress); //i2c address of this unit
  // Enable general-call (I2C broadcast to address 0x00) reception so the
  // master can HOME every unit in a single transaction — see issue #47.
  // Wire.begin() sets TWAR = (addr << 1) and clears TWGCE; set it *after*.
  TWAR |= (1 << TWGCE);
  Wire.onReceive(receiveLetter);//call-function for transfered letter via i2c
  Wire.onRequest(requestEvent); //call-funtion if master requests unit state

  // Runtime watchdog (issue #107): a wedged unit self-recovers instead of
  // needing a power cycle. 8 s window; loop() kicks it every pass and the
  // stepping loops in calibrate()/rotateToLetter() kick it per iteration
  // because low-speed moves legitimately take longer than 8 s. A watchdog
  // reset lands in twiboot, which times out after ~250 ms and restarts the
  // sketch — the same path SFP_CMD_REBOOT already uses — and bumps the EEPROM
  // lifetime watchdog counter (#47), so firings are observable via
  // SFP_CMD_GET_STATUS.
  wdt_enable(WDTO_8S);

  // Boot UNHOMED (#309): NO calibrate() here. Homing all units at once spikes
  // the shared rail and browns out the S3 on a verify-boot (root cause of
  // #305). loop() homes on the first trigger — a master's SFP_CMD_HOME / a
  // letter command, or the staggered self-home fallback. Seed the per-unit
  // jitter from floating-pin ADC noise so coincident boots don't re-synchronize
  // their self-home deadlines (BootHomePolicy.h).
  randomSeed(((uint32_t)analogRead(A0) << 16) ^ micros());
  bootHomeJitterMs = (uint16_t)random(0, (long)BOOT_HOME_JITTER_MAX_MS + 1);

  //test calibration settings
#ifdef TEST_ENABLE
  int calLetters[10] = {0, 26, 1, 21, 14, 43, 30, 31, 32, 39};
  for (int i = 0; i < 10; i++) {
    wdt_reset();
    int currentCalLetter = calLetters[i];
    rotateToLetter(currentCalLetter);
    delay(5000);
  }
#endif
}

void loop() {
  wdt_reset(); //see wdt_enable(WDTO_8S) in setup() (issue #107)

  // Keep the ISR-visible diag/self-test replies current (#263/#265). Cheap
  // (two small encodes + an interrupt-guarded copy) and unconditional, so
  // every drift/state change from the previous pass is published.
  driftRefreshReplyBuffers();
  vitalsRefreshReplyBuffer();  // publish latest Vcc/RAM/cmdPos (#306)
  refreshExtDiagReply();       // publish latest ext-diag measurements (#365)

  //If an enter-bootloader command arrived, give Wire a beat to finish any
  //in-flight transaction, then let the watchdog reset us. Twiboot takes over
  //from there and the master can push a new sketch over I2C.
  if (pendingBootloader) {
#ifdef SERIAL_ENABLE
    Serial.println("Rebooting into twiboot via watchdog");
    Serial.flush();
#endif
    delay(10);
    wdt_enable(WDTO_15MS);
    while (true) {}
  }

  // Interactive calibration: drain the flags set by receiveLetter(). Snapshot
  // with interrupts disabled so a second command arriving mid-handler can't
  // interleave. The motor + EEPROM work then runs with interrupts back on so
  // the Wire ISR can still ACK follow-up transactions.
  if (pendingOffsetWrite) {
    noInterrupts();
    int16_t v = pendingOffsetValue;
    pendingOffsetWrite = false;
    calOffset = v;
    interrupts();
    uint8_t block[EE_CAL_BLOCK_LEN];
    unitEeCalEncode(v, block);
    for (uint8_t i = 0; i < EE_CAL_BLOCK_LEN; i++) {
      EEPROM.update(EE_CAL_OFFSET + i, block[i]);
    }
#ifdef SERIAL_ENABLE
    Serial.print("CalOffset updated to ");
    Serial.println(calOffset);
#endif
    previousMillis = millis();  // keep awake briefly for follow-up commands
  }
  // Feature-gate write (#409). Persisting the byte is the whole op — the gate
  // is read live wherever it is consulted, so nothing has to be restarted for
  // it to take effect, and persistLifetimeHealth() republishes the
  // GET_LIFETIME reply the master verifies the write against.
  //
  // Drained HERE, ahead of the home/jog drains, for the same reason SET_OFFSET
  // is: the master waits a fixed UNIT_GATES_WRITE_SETTLE_MS and then reads
  // GET_LIFETIME back to grade the write. Behind pendingHome that read-back
  // would land mid-calibrate() — seconds — and report a landed write as a
  // refusal. (A re-home we started ourselves can still delay it; the master's
  // settle window is the remaining half of that story.)
  if (pendingGatesWrite) {
    noInterrupts();
    uint8_t v = pendingGatesValue;
    pendingGatesWrite = false;
    interrupts();
    lifetime.featureGates = v;
    persistLifetimeHealth();
    // A gate change invalidates whatever the idle check had accumulated: the
    // streak was built under the old rules.
    idleHallReset(idleHall);
#ifdef SERIAL_ENABLE
    Serial.print("Feature gates set to 0x");
    Serial.println(v, HEX);
#endif
    previousMillis = millis();  // keep awake briefly for follow-up commands
  }
  if (pendingHome) {
    noInterrupts();
    pendingHome = false;
    interrupts();
#ifdef SERIAL_ENABLE
    Serial.println("Home requested");
#endif
    calibrate(true);
    // Park at blank — don't immediately rotate back to the last displayed
    // letter when the main letter-diff check runs below.
    receivedNumber = 0;
    displayedLetter = 0;
    previousMillis = millis();
  }
  if (pendingJogSteps != 0) {
    noInterrupts();
    int8_t steps = pendingJogSteps;
    pendingJogSteps = 0;
    interrupts();
#ifdef SERIAL_ENABLE
    Serial.print("Jog ");
    Serial.println(steps);
#endif
    startMotor();
    stepper.setSpeed(stepperSpeed);
    stepCounted(ROTATIONDIRECTION * (int)steps);
    delay(50);
    stopMotor();
    // Count the jog as a rotation for the anti-overheat gate so a display
    // rotation can't start back-to-back with sustained jogging (#96). Jogs
    // themselves stay ungated: <=127 steps, human-paced from the
    // calibration UI — a 2 s inter-jog cooldown would wreck that UX.
    lastRotation = millis();
    if (lastRotation == 0) lastRotation = 1;  // 0 = "no rotation yet" sentinel
    previousMillis = millis();
  }

  // Provisioning wizard (issue #56). Both address-mutation paths reboot the
  // Nano via the existing pendingBootloader mechanism — getaddress() re-reads
  // EEPROM on the next boot, so the master sees the unit disappear then
  // reappear at the new (or DIP-derived) address. SFP_CMD_REBOOT uses the same
  // reset mechanism; twiboot times out after ~250 ms and the sketch runs.
  if (pendingSetAddress) {
    noInterrupts();
    uint8_t v = pendingAddressValue;
    pendingSetAddress = false;
    interrupts();
    // Reject reserved addresses: 0 is general call, 127 is reserved.
    if (v >= 1 && v <= 126) {
      uint8_t block[EE_ID_BLOCK_LEN];
      unitEeIdentityEncode(v, block);
      for (uint8_t i = 0; i < EE_ID_BLOCK_LEN; i++) {
        EEPROM.update(EE_LAYOUT_VERSION + i, block[i]);
      }
#ifdef SERIAL_ENABLE
      Serial.print("I2C address burned to EEPROM: 0x");
      Serial.println(v, HEX);
#endif
      pendingBootloader = true;
    } else {
      // Loop-context RMW on an ISR-shared counter — guard it (#172).
      noInterrupts();
      if (badCommandCount < 0xFF) badCommandCount++;
      interrupts();
    }
  }
  if (pendingClearAddress) {
    noInterrupts();
    pendingClearAddress = false;
    interrupts();
    // Clearing the provisioned flag leaves a VALID block behind, so the next
    // boot reads "no address burned" rather than "corrupt" — both fall back
    // to DIP, but only one of them is the truth.
    uint8_t block[EE_ID_BLOCK_LEN];
    unitEeIdentityClear(block);
    for (uint8_t i = 0; i < EE_ID_BLOCK_LEN; i++) {
      EEPROM.update(EE_LAYOUT_VERSION + i, block[i]);
    }
#ifdef SERIAL_ENABLE
    Serial.println("EEPROM I2C address cleared, falling back to DIP on reboot");
#endif
    pendingBootloader = true;
  }
  // Odometer maintenance (#231). Reset is a physical-rebuild-only op: zero
  // the RAM counter, the ISR mirror and every ring slot (magic stays — the
  // ring remains initialised). The persist check below it writes the current
  // count into its ring slot every ODO_PERSIST_INTERVAL_REVS revolutions;
  // both EEPROM paths run here in loop context like every other EEPROM write.
  // Accepted window: power loss mid-way through the ring zero leaves stale
  // high slots that boot's ring-max recovery resurrects — user re-issues the
  // reset; not worth ordering the writes for.
  if (pendingOdometerReset) {
    noInterrupts();
    pendingOdometerReset = false;
    odometerRevolutions = 0;
    interrupts();
    odometer.revolutions = 0;
    odometer.stepAccumulator = 0;
    lastPersistedRevs = 0;
    const uint32_t zero = 0;
    const uint8_t zeroSum = odometerSlotChecksum(zero);
    for (uint8_t s = 0; s < ODO_RING_SLOTS; s++) {
      // A full 128-slot ring is 640 byte-writes — seconds of EEPROM time in
      // the worst case, well past the 8 s window without feeding (#107).
      wdt_reset();
      int at = EE_ODO_RING_BASE + (int)odometerSlotOffset(s);
      EEPROM.put(at, zero);
      EEPROM.update(at + 4, zeroSum);
    }
#ifdef SERIAL_ENABLE
    Serial.println("Odometer reset");
#endif
    previousMillis = millis();
  }
  if (odometerShouldPersist(odometer.revolutions, lastPersistedRevs)) {
    uint32_t revs = odometer.revolutions;  // shadow for EEPROM.put
    int at = EE_ODO_RING_BASE + (int)odometerSlotOffset(odometerSlotIndex(revs));
    // Value then checksum (#354): a power loss between the two leaves a
    // mismatched slot that boot recovery skips — the previous slot's count
    // is adopted instead of torn garbage. Interleaved, so the pair is one
    // contiguous 5-byte write rather than two at distant addresses.
    EEPROM.put(at, revs);
    EEPROM.update(at + 4, odometerSlotChecksum(revs));
    lastPersistedRevs = revs;
  }

  // On-demand self-test (#265): ~2 revolutions of blocking diagnostic
  // motion, so it drains here like every other motor op. The unit reports
  // busy (currentlyrotating) throughout; the letter-diff check below
  // restores the commanded letter afterwards (runSelfTest parks at blank).
  if (pendingSelfTest) {
    noInterrupts();
    pendingSelfTest = false;
    interrupts();
#ifdef SERIAL_ENABLE
    Serial.println("Self-test requested");
#endif
    runSelfTest();
    previousMillis = millis();
  }

  if (pendingIdentify) {
    noInterrupts();
    pendingIdentify = false;
    interrupts();
    // Reserve 0 as the "not identifying" sentinel; in the unlikely case
    // millis() returns exactly 0 here, bump to 1 so the blink runs.
    identifyStartMs = millis();
    if (identifyStartMs == 0) identifyStartMs = 1;
#ifdef SERIAL_ENABLE
    Serial.println("Identify");
#endif
  }

  unsigned long currentMillis = millis();

  // Non-blocking identify blink (issue #56). 4 Hz for 3 s, then LED off.
  // Reset the sleep timer while blinking so SLEEP_MODE_IDLE doesn't stall
  // the blink (CPU clock stops in idle sleep, so the toggles would pause).
  if (identifyStartMs != 0) {
    previousMillis = currentMillis;
    unsigned long elapsed = currentMillis - identifyStartMs;
    if (elapsed >= 3000) {
      digitalWrite(LED_BUILTIN, LOW);
      identifyStartMs = 0;
    } else {
      digitalWrite(LED_BUILTIN, ((elapsed / 125) & 1) == 0 ? HIGH : LOW);
    }
  }

  // Uptime counter for SFP_CMD_GET_STATUS (issue #47). Saturating at 18 h 12 min;
  // the master is expected to poll more often than that. Cheap arithmetic,
  // fine to recompute every loop iteration.
  uint32_t secondsSinceBoot = currentMillis / 1000UL;
  uint16_t newUptime = (secondsSinceBoot > 0xFFFFUL) ? 0xFFFF : (uint16_t)secondsSinceBoot;
  noInterrupts();
  uptimeSeconds = newUptime;
  interrupts();

  // Staggered boot-home fallback (#309). The unit boots unhomed; if no master
  // orchestrates a home it self-homes on a deadline — staggered by address when
  // standalone, or the hard cap when a master is present but silent. Triggers 1
  // (SFP_CMD_HOME via pendingHome) and 2 (a letter while unhomed, in
  // rotateToLetter) home through their own paths and set `homed`, disabling
  // this. Guarded to a single attempt: a unit whose hall never fires must not
  // re-home every pass (calibrate() has no overheat gate — it would cook the
  // motor). A later master SFP_CMD_HOME is still an explicit retry.
  if (!homed && !bootHomeAttempted) {
    BootHomeInputs bh;
    bh.homed = homed;
    bh.masterEverContacted = masterEverContacted;
    bh.elapsedMs = currentMillis;  // millis() since boot (bootMs ~= 0)
    bh.dipIndex = (uint8_t)(i2cAddress - SFP_I2C_ADDRESS_BASE);
    bh.jitterMs = bootHomeJitterMs;
    if (bootHomeShouldSelfHome(bh)) {
      bootHomeAttempted = true;
      calibrate(true);        // sets `homed` on success; parks belief at blank
      receivedNumber = 0;
      displayedLetter = 0;
      previousMillis = millis();
    }
  }

  // Idle Vcc/RAM sample (#306), throttled to ~1 Hz so the ADC conversion
  // (~2 ms with settling) doesn't tax the superloop. Keeps vccNow fresh for a
  // curl even when the drum hasn't moved; loaded samples from rotateToLetter()
  // still own the vccMin sag. millis()==0 at boot is fine — the setup() sample
  // already seeded vccNow, and this just refreshes on the next second.
  if (currentMillis - vitalsLastSampleMs >= 1000UL) {
    vitalsLastSampleMs = currentMillis;
    vitalsSample(false);
  }

  // Duty-window decay (#373): halve the rolling move counter on a coarse ~60 s
  // timer so it tracks recent activity, not lifetime moves. Exponential decay
  // is a cheap rolling window — no per-move timestamp history to store.
  static unsigned long extDutyDecayMs = 0;
  if (currentMillis - extDutyDecayMs >= 60000UL) {
    extDutyDecayMs = currentMillis;
    // (extDutyWindow >> 1) subtracted from itself sticks at 1 forever (1-0=1);
    // floor to 0 below that so an idle unit's window actually reaches 0.
    extDutyWindow = (extDutyWindow > 1) ? (uint16_t)(extDutyWindow - (extDutyWindow >> 1)) : 0;
  }

  // Idle hall consistency check (#268), dormant unless UNIT_GATE_IDLE_HALL_CHECK
  // is set (#407 ships both motion gates off; #409's SET_GATES turns them on).
  // Hand-rotating a parked drum is invisible today — the hall is sampled only
  // while stepping, so the unit keeps believing its last commanded letter until
  // some later move happens to sweep the magnet. At rest the same one bit still
  // polices the belief: the tracked position predicts whether the sensor should
  // see the magnet, and a contradiction that survives the debounce means the
  // drum moved without us. It arms the SAME driftPending a mid-move observation
  // does, so the re-home below is the entire correction path — this adds a
  // digitalRead every 250 ms and no new motion of its own.
  //
  // Suppressed unless the drum is genuinely parked and nothing is about to
  // touch it: an unhomed or never-synced position has no expectation to
  // contradict, and a pending op, an identify blink or an in-flight letter all
  // mean the prediction is about to be stale. Every one of those also RESETS
  // the streak — a streak that survived a move would be judging the old park.
  bool idleHallEligible =
      unitGateEnabled(lifetime.featureGates, UNIT_GATE_IDLE_HALL_CHECK) &&
      !idleHallStandDown(idleHallFutileRehomes) &&
      homed && drift.positionKnown && !drift.driftPending &&
      currentlyrotating == 0 && displayedLetter == receivedNumber &&
      identifyStartMs == 0 && !pendingSelfTest && !pendingHome &&
      !pendingBootloader && pendingJogSteps == 0;
  if (!idleHallEligible) {
    idleHallReset(idleHall);
  } else if (currentMillis - idleHallLastSampleMs >=
             IDLE_HALL_SAMPLE_INTERVAL_MS) {
    idleHallLastSampleMs = currentMillis;
    // The unit's own measured hall window when it has one (#406 persists it
    // across reboots), the conservative constant otherwise.
    IdleHallWindow window =
        idleHallResolveWindow(lifetime.selfTestLastHallWindow, STEPS);
    uint8_t expectation =
        idleHallExpectation(drift.drumPosition, window, STEPS);
    if (idleHallObserve(idleHall, expectation, digitalRead(HALLPIN) == 0)) {
      drift.driftPending = true;
      idleHallArmedRehome = true;
#ifdef SERIAL_ENABLE
      Serial.print("Idle hall mismatch at position ");
      Serial.println(drift.drumPosition);
#endif
    }
  }

  // Silent drift correction (#263): a mid-move hall observation measured
  // the drum off its belief. Re-home at idle only — the display quiet for
  // WAIT_TIME (the same 2 s window the sleep gate below uses), no pending
  // letter change, and the once-per-cooldown cap — then the letter-diff
  // check below rotates back to the commanded letter (calibrate parks the
  // belief at blank). The overheat gate is already satisfied by the quiet
  // window, so the restore move runs immediately.
  if (drift.driftPending && displayedLetter == receivedNumber &&
      currentMillis - previousMillis >= WAIT_TIME &&
      (lastAutoRehomeMs == 0 ||
       currentMillis - lastAutoRehomeMs >= DRIFT_REHOME_COOLDOWN_MS)) {
#ifdef SERIAL_ENABLE
    Serial.print("Drift re-home, last drift steps: ");
    Serial.println(drift.lastDriftSteps);
#endif
    lastAutoRehomeMs = currentMillis == 0 ? 1 : currentMillis;
    uint8_t eventsBefore = drift.driftEvents;
    bool wasArmedByIdleCheck = idleHallArmedRehome;
    idleHallArmedRehome = false;
    calibrate(true);  // clears drift.driftPending, parks belief at blank
    // calibrate's edge observation bumps driftEvents only when the belief was
    // measurably wrong. If we armed this re-home and it found nothing, the
    // drum was where we thought — the window model contradicted a correct
    // belief, and re-homing again will change nothing.
    if (wasArmedByIdleCheck) {
      if (drift.driftEvents == eventsBefore) {
        if (idleHallFutileRehomes < 0xFF) idleHallFutileRehomes++;
#ifdef SERIAL_ENABLE
        Serial.print("Idle hall re-home found no drift; futile count ");
        Serial.println(idleHallFutileRehomes);
#endif
      } else {
        idleHallFutileRehomes = 0;  // a real catch re-earns the credit
      }
    }
    previousMillis = millis();
  }

  if (currentMillis - previousMillis >= WAIT_TIME) {
    set_sleep_mode(SLEEP_MODE_IDLE);
    sleep_enable();
#ifdef SERIAL_ENABLE
    digitalWrite (LED_BUILTIN, LOW); // shuts off LED when starting to sleep, for debugging
#endif
    sleep_cpu();
#ifdef SERIAL_ENABLE
    digitalWrite (LED_BUILTIN, HIGH); // turns on LED when waking up, for debugging
#endif
    sleep_disable();
    previousMillis = currentMillis; //reset sleep counter
  }  // end of time to sleep

  //check if new letter was received through i2c
  if (displayedLetter != receivedNumber)
  {
    /*
      #ifdef SERIAL_ENABLE
      Serial.print("Value over serial received: ");
      Serial.print(receivedNumber);
      Serial.print(" Letter: ");
      Serial.print((char)pgm_read_byte(&LETTER_CHARS[receivedNumber]));
      Serial.println();
      #endif
    */
    //rotate to new letter
    rotateToLetter(receivedNumber);
  }
}
