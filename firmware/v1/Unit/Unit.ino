/*********
  Split Flap Arduino Nano Unit
*********/

//#define SERIAL_ENABLE // uncomment for serial debug communication
//#define TEST_ENABLE   // uncomment for Test mode. Rotates through a few character to make sure unit is working. These characters should be displayed in the correct order: " ", "Z", "A", "U", "N", "?", "0", "1", "2", "9"

#include <Arduino.h>
#include <Wire.h>
#include <Stepper.h>
#include <EEPROM.h>
#include <avr/sleep.h>
#include <avr/wdt.h>
#include "BuildVersion.h"  // GIT_REV, generated by build_version.py
// Single source of truth for the master<->unit I2C contract (opcodes, address
// base, alphabet, flap count), shared with firmware/v1/ESPMaster (#149).
#include "SplitFlapProtocol.h"

// Pins of I2C adress switch
#define ADRESSSW1 6
#define ADRESSSW2 5
#define ADRESSSW3 4
#define ADRESSSW4 3

// I2C address base (SFP_I2C_ADDRESS_BASE) is defined in SplitFlapProtocol.h.

// EEPROM layout:
//   0..1  int   calibration offset (set via master web-UI calibration)
//   2     byte  identity magic — if == EEPROM_ID_MAGIC_VALUE, byte 3 is valid
//   3     byte  I2C address (1..126) assigned by the position wizard (future)
//   4     byte  lifetime brownout-reset count (saturating)  (issue #47)
//   5     byte  lifetime watchdog-reset count (saturating)  (issue #47)
//   6     byte  health-counter init magic — if == EEPROM_HEALTH_MAGIC_VALUE,
//               slots 4/5 are initialised; else they're fresh 0xFF (#139)
// Slots 7+ reserved.
#define EEPROM_ADDR_ID_MAGIC      2
#define EEPROM_ADDR_I2C_ADDR      3
#define EEPROM_ADDR_BROWNOUT_CNT  4
#define EEPROM_ADDR_WATCHDOG_CNT  5
#define EEPROM_ADDR_HEALTH_MAGIC  6
#define EEPROM_ID_MAGIC_VALUE     0xA5
#define EEPROM_HEALTH_MAGIC_VALUE 0x5A

// I2C "receive" namespace: the first byte is a letter index (0..AMOUNTFLAPS-1)
// for normal display commands, or a command opcode (>= AMOUNTFLAPS) for
// control commands. The opcodes (SFP_CMD_*) and their semantic bands are
// defined once in SplitFlapProtocol.h and shared with the master (#149).

//constants stepper
#define STEPPERPIN1 11
#define STEPPERPIN2 10
#define STEPPERPIN3 9
#define STEPPERPIN4 8
#define STEPS 2038 //28BYJ-48 stepper, number of steps
// The protocol's SET_OFFSET bound is defined as one revolution of THIS drum;
// if the stepper ever changes, SplitFlapProtocol.h must change with it (#171).
static_assert(STEPS == SFP_OFFSET_LIMIT_STEPS,
              "SFP_OFFSET_LIMIT_STEPS must equal the drum's steps per revolution");
#define HALLPIN 7 //Pin of hall sensor
#define AMOUNTFLAPS SFP_FLAP_AMOUNT  // derived from SFP_ALPHABET (SplitFlapProtocol.h, #149)

//constants others
#define BAUDRATE 115200
#define HOMING_RPM 10 //fixed speed for homing (issue #108). Homing used to run at whatever speed the last message used — a fast message followed by a HOME homed fast, risking overshooting the hall window and inconsistent zero points.
#define ROTATIONDIRECTION 1 //-1 for reverse direction (swap if the drum rotates the wrong way)
#define OVERHEATINGTIMEOUT 2 //timeout in seconds to avoid overheating of stepper. After starting rotation, the counter will start. Stepper won't move again until timeout is passed
unsigned long lastRotation = 0;

//globals
//displayedLetter is written from loop context (rotateToLetter/calibrate) and
//read by requestEvent() in the TWI ISR for SFP_CMD_GET_LETTER — volatile for the
//same LTO-visibility reason as the pending* flags. Values fit in one byte,
//so the non-atomic int access is harmless (#106).
volatile int displayedLetter = 0; //currently shown letter
//Sourced from SFP_ALPHABET (SplitFlapProtocol.h, #149) so master, unit and
//script.js can never drift. ä/ö/ü are wire-encoded as $ & #; the web UI
//translates user input before sending. Letters are only used for serial
//debug prints; the actual rotation is index-based, so changing this string
//never changes what the physical drum shows. Flash-resident: the previous
//Arduino String array burned ~350 bytes of the 2 KB SRAM (issue #109).
const char LETTER_CHARS[] PROGMEM = SFP_ALPHABET;
static_assert(sizeof(LETTER_CHARS) - 1 == AMOUNTFLAPS, "LETTER_CHARS must have exactly AMOUNTFLAPS entries");
Stepper stepper(STEPS, STEPPERPIN1, STEPPERPIN3, STEPPERPIN2, STEPPERPIN4); //stepper setup
bool lastInd1 = false; //store last status of phase
bool lastInd2 = false; //store last status of phase
bool lastInd3 = false; //store last status of phase
bool lastInd4 = false; //store last status of phase
float missedSteps = 0; //cummulate steps <1, to compensate via additional step when reaching >1
// STEPS/AMOUNTFLAPS is non-integer (2038/45 ≈ 45.29). Precompute the whole and
// fractional parts once — the float division used to run every step inside
// rotateToLetter, and float division is slow on AVR. See stepFlaps() (#136).
static const int   STEPS_PER_FLAP_WHOLE = STEPS / AMOUNTFLAPS;
static const float STEPS_PER_FLAP_FRAC  = (float)STEPS / (float)AMOUNTFLAPS - (float)STEPS_PER_FLAP_WHOLE;
// volatile: read inside the Wire ISR (requestEvent() status/idle byte the
// master polls) and written all over loop() (startMotor/stopMotor/calibrate
// and the overheat-gate early return in rotateToLetter). Without it, LTO can
// serve the ISR a stale 0 and the master's waitForDisplayToStop() concludes
// idle prematurely (#143). Value is 0/1, so non-atomic 16-bit access is
// harmless — same rationale as receivedNumber/stepperSpeed below.
volatile int currentlyrotating = 0; // 1 = drum is currently rotating, 0 = drum is standing still
// receivedNumber and stepperSpeed are written from the Wire ISR
// (receiveLetter) and read in loop()/rotateToLetter() — volatile for the
// same reason as the pending* flags (LTO may otherwise cache them). Values
// fit in the low byte, so the non-atomic 16-bit access is harmless.
volatile int stepperSpeed = 10; //current speed of stepper, from the last letter command; default only matters for a jog before any message (homing uses HOMING_RPM)
int eeAddress = 0;   //EEPROM address for calibration offset
// Read by requestEvent() in the TWI ISR (SFP_CMD_GET_OFFSET reply) — volatile
// for LTO visibility like every other ISR-shared field here (#143/#173).
// EEPROM.get/put's templates reject volatile refs: go through a non-volatile
// local shadow at those two sites (getOffset(), the pendingOffsetWrite drain).
volatile int calOffset; //Offset for calibration in steps, stored in EEPROM, gets read in setup
volatile int receivedNumber = 0;
int i2cAddress;

// Set by the I2C receive handler when an enter-bootloader command arrives;
// the main loop then triggers a watchdog reset (doing the reset from inside
// the Wire ISR is risky — we want the I2C transaction to finish cleanly).
volatile bool pendingBootloader = false;

// When true, the next requestEvent() returns the 8-byte GIT_REV instead of
// the rotation-status byte. Flag set by receiveLetter() on SFP_CMD_GET_VERSION,
// cleared after the response is sent so subsequent reads fall back to status.
volatile bool pendingVersionResponse = false;

// Interactive calibration flags (issue #32). Each is set from inside the
// Wire ISR by receiveLetter(); loop() drains the non-response ones and
// requestEvent() drains pendingOffsetResponse. The motor/EEPROM work
// cannot run inside the ISR — EEPROM writes take ~7 ms per 2 bytes and
// stepping blocks for tens of ms per step.
volatile bool    pendingOffsetResponse = false;   // consumed by requestEvent
volatile bool    pendingOffsetWrite    = false;   // loop() persists + updates
volatile int16_t pendingOffsetValue    = 0;
volatile bool    pendingHome           = false;   // loop() re-homes
volatile int8_t  pendingJogSteps       = 0;       // loop() steps + clears

// Provisioning flags (issue #56). EEPROM writes and reboots can't run from
// the Wire ISR — defer to loop() like every other mutation. identifyStartMs
// is a plain unsigned long because it's only written by loop() once the
// pendingIdentify flag is consumed; 0 means "not currently identifying".
volatile bool    pendingSetAddress      = false;
volatile uint8_t pendingAddressValue    = 0;
volatile bool    pendingClearAddress    = false;
volatile bool    pendingIdentify        = false;
unsigned long    identifyStartMs        = 0;

// Health / diagnostics state returned by SFP_CMD_GET_STATUS (issue #47).
volatile bool     pendingStatusResponse     = false;  // consumed by requestEvent
volatile bool     pendingLetterResponse     = false;  // consumed by requestEvent (#106)
uint8_t           savedMcusr                = 0;      // snapshot of MCUSR at boot
uint8_t           lifetimeBrownoutCount     = 0;      // mirror of EEPROM slot 4
uint8_t           lifetimeWatchdogCount     = 0;      // mirror of EEPROM slot 5
// Incremented from BOTH the TWI ISR (receiveLetter) and loop() (the invalid-
// address branch of the pendingSetAddress drain) and read back in the ISR's
// status reply — volatile for LTO visibility, and the loop-side RMW must be
// wrapped in noInterrupts()/interrupts() or a concurrent ISR increment is
// lost (#172). Single-byte, so the ISR-side increments are atomic as-is.
volatile uint8_t  badCommandCount           = 0;      // saturating, malformed I2C receives since boot
// The four status fields below are written from loop context (calibrate()/
// loop()) and read by requestEvent() in the TWI ISR — volatile, and the
// 16-bit ones are written under noInterrupts() so the ISR can't see a
// torn half-written value (#96, same class as the calOffset fix).
volatile bool     statusLastHomeFailed      = false;  // set by calibrate() on timeout
volatile bool     statusHallNeverTriggered  = false;  // set by calibrate() when hall never read 0
volatile uint16_t lastHomingStepCount       = 0;      // steps the last calibrate() took to find hall
volatile uint16_t uptimeSeconds             = 0;      // saturating; updated from loop()

//sleep globals
//Sleep mode is SLEEP_MODE_IDLE: CPU clock stops, peripheral clocks (including
//TWI) keep running so the unit can still ACK I2C transactions while asleep.
//SLEEP_MODE_PWR_DOWN was tried originally but it clock-gates TWI, which made
//the master see spurious -1 reads whenever a unit happened to be sleeping
//during a poll — see issue #22.
const unsigned long WAIT_TIME = 2000;    //wait time before sleep routine gets executed again in milliseconds
unsigned long previousMillis = 0;       //stores last time sleep was interrupted

//setup
void setup() {
  // Capture MCUSR *before* clearing — it tells us why we last reset
  // (brownout / watchdog / external / power-on / jtag). Kept around for
  // SFP_CMD_GET_STATUS byte 1, and used right now to bump the lifetime
  // reset counters in EEPROM. See issue #47.
  savedMcusr = MCUSR;
  MCUSR = 0;
  wdt_disable();

  // Lifetime reset counters: persist across power cycles so a unit with
  // chronic power issues (brownouts) can be diagnosed even if the master
  // only polls once. Saturating at 255 — once we're there the signal is
  // already loud enough.
  //
  // Fresh/erased AVR EEPROM reads back 0xFF on every byte, which would
  // masquerade as 255 saturated resets — and the saturating guard below then
  // pins them there forever (every freshly-provisioned unit reported 255/255,
  // #139). A dedicated magic byte marks the counter block as initialised; when
  // it's absent we zero the counters once and stamp the magic.
  if (EEPROM.read(EEPROM_ADDR_HEALTH_MAGIC) == EEPROM_HEALTH_MAGIC_VALUE) {
    lifetimeBrownoutCount = EEPROM.read(EEPROM_ADDR_BROWNOUT_CNT);
    lifetimeWatchdogCount = EEPROM.read(EEPROM_ADDR_WATCHDOG_CNT);
  } else {
    lifetimeBrownoutCount = 0;
    lifetimeWatchdogCount = 0;
    EEPROM.update(EEPROM_ADDR_BROWNOUT_CNT, 0);
    EEPROM.update(EEPROM_ADDR_WATCHDOG_CNT, 0);
    EEPROM.update(EEPROM_ADDR_HEALTH_MAGIC, EEPROM_HEALTH_MAGIC_VALUE);
  }
  if (savedMcusr & (1 << BORF) && lifetimeBrownoutCount < 0xFF) {
    lifetimeBrownoutCount++;
    EEPROM.update(EEPROM_ADDR_BROWNOUT_CNT, lifetimeBrownoutCount);
  }
  if (savedMcusr & (1 << WDRF) && lifetimeWatchdogCount < 0xFF) {
    lifetimeWatchdogCount++;
    EEPROM.update(EEPROM_ADDR_WATCHDOG_CNT, lifetimeWatchdogCount);
  }

  // i2c adress switch
  pinMode(ADRESSSW1, INPUT_PULLUP);
  pinMode(ADRESSSW2, INPUT_PULLUP);
  pinMode(ADRESSSW3, INPUT_PULLUP);
  pinMode(ADRESSSW4, INPUT_PULLUP);

  //hall sensor
  pinMode(HALLPIN, INPUT);

  // Onboard LED drives SFP_CMD_IDENTIFY blink (issue #56). Without OUTPUT mode
  // digitalWrite only toggles the pull-up, so pre-existing SERIAL_ENABLE
  // debug LED uses were effectively no-ops. Harmless to set unconditionally.
  pinMode(LED_BUILTIN, OUTPUT);
  digitalWrite(LED_BUILTIN, LOW);

  i2cAddress = getaddress(); //get I2C Address and save in variable

#ifdef SERIAL_ENABLE
  //initialize serial
  Serial.begin(BAUDRATE);
  Serial.println("starting unit");
  Serial.print("I2CAddress: ");
  Serial.println(i2cAddress);
#endif

  // Read the calibration offset BEFORE the Wire handlers go live (#173):
  // EEPROM.get into the 2-byte calOffset is not atomic, and requestEvent()
  // reads calOffset from the TWI ISR — registering first left a boot-time
  // window where a GET_OFFSET reply could see a torn half-written value
  // (same class as the #96/#143 fixes). All later writes happen in loop()
  // under noInterrupts(), so this ordering closes the only unguarded one.
  getOffset();

  //I2C function assignment
  Wire.begin(i2cAddress); //i2c address of this unit
  // Enable general-call (I2C broadcast to address 0x00) reception so the
  // master can HOME every unit in a single transaction — see issue #47.
  // Wire.begin() sets TWAR = (addr << 1) and clears TWGCE; set it *after*.
  TWAR |= (1 << TWGCE);
  Wire.onReceive(receiveLetter);//call-function for transfered letter via i2c
  Wire.onRequest(requestEvent); //call-funtion if master requests unit state

  // Runtime watchdog (issue #107): a wedged unit self-recovers instead of
  // needing a power cycle. 8 s window; loop() kicks it every pass and the
  // stepping loops in calibrate()/rotateToLetter() kick it per iteration
  // because low-speed moves legitimately take longer than 8 s. A watchdog
  // reset lands in twiboot, which times out after ~250 ms and restarts the
  // sketch — the same path SFP_CMD_REBOOT already uses — and bumps the EEPROM
  // lifetime watchdog counter (#47), so firings are observable via
  // SFP_CMD_GET_STATUS.
  wdt_enable(WDTO_8S);

  calibrate(true); //home stepper after startup (offset read earlier, #173)

  //test calibration settings
#ifdef TEST_ENABLE
  int calLetters[10] = {0, 26, 1, 21, 14, 43, 30, 31, 32, 39};
  for (int i = 0; i < 10; i++) {
    wdt_reset();
    int currentCalLetter = calLetters[i];
    rotateToLetter(currentCalLetter);
    delay(5000);
  }
#endif
}

void loop() {
  wdt_reset(); //see wdt_enable(WDTO_8S) in setup() (issue #107)

  //If an enter-bootloader command arrived, give Wire a beat to finish any
  //in-flight transaction, then let the watchdog reset us. Twiboot takes over
  //from there and the master can push a new sketch over I2C.
  if (pendingBootloader) {
#ifdef SERIAL_ENABLE
    Serial.println("Rebooting into twiboot via watchdog");
    Serial.flush();
#endif
    delay(10);
    wdt_enable(WDTO_15MS);
    while (true) {}
  }

  // Interactive calibration: drain the flags set by receiveLetter(). Snapshot
  // with interrupts disabled so a second command arriving mid-handler can't
  // interleave. The motor + EEPROM work then runs with interrupts back on so
  // the Wire ISR can still ACK follow-up transactions.
  if (pendingOffsetWrite) {
    noInterrupts();
    int16_t v = pendingOffsetValue;
    pendingOffsetWrite = false;
    calOffset = v;
    interrupts();
    int persisted = v;  //shadow: EEPROM.put can't take the volatile directly
    EEPROM.put(eeAddress, persisted);
#ifdef SERIAL_ENABLE
    Serial.print("CalOffset updated to ");
    Serial.println(calOffset);
#endif
    previousMillis = millis();  // keep awake briefly for follow-up commands
  }
  if (pendingHome) {
    noInterrupts();
    pendingHome = false;
    interrupts();
#ifdef SERIAL_ENABLE
    Serial.println("Home requested");
#endif
    calibrate(true);
    // Park at blank — don't immediately rotate back to the last displayed
    // letter when the main letter-diff check runs below.
    receivedNumber = 0;
    displayedLetter = 0;
    previousMillis = millis();
  }
  if (pendingJogSteps != 0) {
    noInterrupts();
    int8_t steps = pendingJogSteps;
    pendingJogSteps = 0;
    interrupts();
#ifdef SERIAL_ENABLE
    Serial.print("Jog ");
    Serial.println(steps);
#endif
    startMotor();
    stepper.setSpeed(stepperSpeed);
    stepper.step(ROTATIONDIRECTION * (int)steps);
    delay(50);
    stopMotor();
    // Count the jog as a rotation for the anti-overheat gate so a display
    // rotation can't start back-to-back with sustained jogging (#96). Jogs
    // themselves stay ungated: <=127 steps, human-paced from the
    // calibration UI — a 2 s inter-jog cooldown would wreck that UX.
    lastRotation = millis();
    previousMillis = millis();
  }

  // Provisioning wizard (issue #56). Both address-mutation paths reboot the
  // Nano via the existing pendingBootloader mechanism — getaddress() re-reads
  // EEPROM on the next boot, so the master sees the unit disappear then
  // reappear at the new (or DIP-derived) address. SFP_CMD_REBOOT uses the same
  // reset mechanism; twiboot times out after ~250 ms and the sketch runs.
  if (pendingSetAddress) {
    noInterrupts();
    uint8_t v = pendingAddressValue;
    pendingSetAddress = false;
    interrupts();
    // Reject reserved addresses: 0 is general call, 127 is reserved.
    if (v >= 1 && v <= 126) {
      EEPROM.update(EEPROM_ADDR_I2C_ADDR, v);
      EEPROM.update(EEPROM_ADDR_ID_MAGIC, EEPROM_ID_MAGIC_VALUE);
#ifdef SERIAL_ENABLE
      Serial.print("I2C address burned to EEPROM: 0x");
      Serial.println(v, HEX);
#endif
      pendingBootloader = true;
    } else {
      // Loop-context RMW on an ISR-shared counter — guard it (#172).
      noInterrupts();
      if (badCommandCount < 0xFF) badCommandCount++;
      interrupts();
    }
  }
  if (pendingClearAddress) {
    noInterrupts();
    pendingClearAddress = false;
    interrupts();
    // Anything != EEPROM_ID_MAGIC_VALUE makes getaddress() fall back to DIP.
    EEPROM.update(EEPROM_ADDR_ID_MAGIC, 0xFF);
#ifdef SERIAL_ENABLE
    Serial.println("EEPROM I2C address cleared, falling back to DIP on reboot");
#endif
    pendingBootloader = true;
  }
  if (pendingIdentify) {
    noInterrupts();
    pendingIdentify = false;
    interrupts();
    // Reserve 0 as the "not identifying" sentinel; in the unlikely case
    // millis() returns exactly 0 here, bump to 1 so the blink runs.
    identifyStartMs = millis();
    if (identifyStartMs == 0) identifyStartMs = 1;
#ifdef SERIAL_ENABLE
    Serial.println("Identify");
#endif
  }

  unsigned long currentMillis = millis();

  // Non-blocking identify blink (issue #56). 4 Hz for 3 s, then LED off.
  // Reset the sleep timer while blinking so SLEEP_MODE_IDLE doesn't stall
  // the blink (CPU clock stops in idle sleep, so the toggles would pause).
  if (identifyStartMs != 0) {
    previousMillis = currentMillis;
    unsigned long elapsed = currentMillis - identifyStartMs;
    if (elapsed >= 3000) {
      digitalWrite(LED_BUILTIN, LOW);
      identifyStartMs = 0;
    } else {
      digitalWrite(LED_BUILTIN, ((elapsed / 125) & 1) == 0 ? HIGH : LOW);
    }
  }

  // Uptime counter for SFP_CMD_GET_STATUS (issue #47). Saturating at 18 h 12 min;
  // the master is expected to poll more often than that. Cheap arithmetic,
  // fine to recompute every loop iteration.
  uint32_t secondsSinceBoot = currentMillis / 1000UL;
  uint16_t newUptime = (secondsSinceBoot > 0xFFFFUL) ? 0xFFFF : (uint16_t)secondsSinceBoot;
  noInterrupts();
  uptimeSeconds = newUptime;
  interrupts();

  if (currentMillis - previousMillis >= WAIT_TIME) {
    set_sleep_mode(SLEEP_MODE_IDLE);
    sleep_enable();
#ifdef SERIAL_ENABLE
    digitalWrite (LED_BUILTIN, LOW); // shuts off LED when starting to sleep, for debugging
#endif
    sleep_cpu();
#ifdef SERIAL_ENABLE
    digitalWrite (LED_BUILTIN, HIGH); // turns on LED when waking up, for debugging
#endif
    sleep_disable();
    previousMillis = currentMillis; //reset sleep counter
  }  // end of time to sleep

  //check if new letter was received through i2c
  if (displayedLetter != receivedNumber)
  {
    /*
      #ifdef SERIAL_ENABLE
      Serial.print("Value over serial received: ");
      Serial.print(receivedNumber);
      Serial.print(" Letter: ");
      Serial.print((char)pgm_read_byte(&LETTER_CHARS[receivedNumber]));
      Serial.println();
      #endif
    */
    //rotate to new letter
    rotateToLetter(receivedNumber);
  }
}
