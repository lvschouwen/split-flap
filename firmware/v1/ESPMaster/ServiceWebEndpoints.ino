// Normal-boot web endpoint registration, extracted from ESPMaster.ino (#148).
// One translation unit with ESPMaster.ino (which sorts earlier), so the async
// server types, WebAssets PROGMEM arrays and all globals are visible here.
// Called once from setup() after WiFi/NTP come up; prototype in ESPMaster.h.
// The recovery/quiet-OTA minimal servers are NOT here — they live with their
// enter*Mode() functions in ServiceBootModes.ino.
//
// Async-context rule (#150): these handlers run in async_tcp/LWIP context.
// They may parse, validate, read state and respond — they must NOT mutate
// shared Strings, commit EEPROM, call configTime, or hold the Wire bus for
// long/multi-transaction work. Mutating work is staged behind a flag or
// struct (pendingSettingsPost, isPendingStop, mqttDiscoverPending,
// reflashUnitsPending, unitHealthRefreshPending, isPending*) and drained
// from loop().
// Deliberate exceptions: the calibration endpoints (/unit/offset, /unit/jog,
// /unit/home, /unit/reboot) perform ONE short (<10 ms) synchronous I2C
// transaction in the handler because the HTTP response reports the I2C
// result; ESP8266's cooperative scheduler never preempts loop() mid-Wire-
// transaction, and all of them are gated on the firmware-flash window.
// RTC-memory writes (/firmware/recover-mark, /firmware/ota-mode) are
// microsecond register writes — no flash involved — and stay inline too.

void registerWebEndpoints() {
    //Web Server Endpoint configuration — all assets served from PROGMEM
    //(generated by build_assets.py into WebAssets.h). Gzipped entries are
    //sent with Content-Encoding: gzip; browsers unpack transparently.
    //Static assets live in PROGMEM and only change via a master OTA.
    //Tell the browser to revalidate every navigation so an OTA that
    //swaps the UI doesn't leave stale HTML/JS in the tab cache.
    webServer.on("/", HTTP_GET, [](AsyncWebServerRequest * request) {
      SerialPrintln(F("Request Home Page Received"));
      AsyncWebServerResponse *resp = request->beginResponse_P(200, "text/html", INDEX_HTML_GZ, INDEX_HTML_GZ_LEN);
      resp->addHeader("Content-Encoding", "gzip");
      resp->addHeader("Cache-Control", "no-cache");
      request->send(resp);
    });
    webServer.on("/index.html", HTTP_GET, [](AsyncWebServerRequest * request) {
      AsyncWebServerResponse *resp = request->beginResponse_P(200, "text/html", INDEX_HTML_GZ, INDEX_HTML_GZ_LEN);
      resp->addHeader("Content-Encoding", "gzip");
      resp->addHeader("Cache-Control", "no-cache");
      request->send(resp);
    });
    webServer.on("/script.js", HTTP_GET, [](AsyncWebServerRequest * request) {
      AsyncWebServerResponse *resp = request->beginResponse_P(200, "application/javascript", SCRIPT_JS_GZ, SCRIPT_JS_GZ_LEN);
      resp->addHeader("Content-Encoding", "gzip");
      resp->addHeader("Cache-Control", "no-cache");
      request->send(resp);
    });
    webServer.on("/style.css", HTTP_GET, [](AsyncWebServerRequest * request) {
      AsyncWebServerResponse *resp = request->beginResponse_P(200, "text/css", STYLE_CSS_GZ, STYLE_CSS_GZ_LEN);
      resp->addHeader("Content-Encoding", "gzip");
      resp->addHeader("Cache-Control", "no-cache");
      request->send(resp);
    });
    webServer.on("/favicon.png", HTTP_GET, [](AsyncWebServerRequest * request) {
      request->send_P(200, "image/png", FAVICON_PNG, FAVICON_PNG_LEN);
    });

    webServer.on("/settings", HTTP_GET, [](AsyncWebServerRequest * request) {
      SerialPrintln(F("Request for Settings Received"));
      
      String json = getCurrentSettingValues();
      request->send(200, "application/json", json);
      json = String();
    });
    
    webServer.on("/health", HTTP_GET, [](AsyncWebServerRequest * request) {
      SerialPrintln(F("Request for Health Check Received"));
      request->send(200, "text/plain", "Healthy");
    });

#if USE_MULTICAST == true
    //MQTT broker auto-detect (#129). POST arms the discovery; the blocking
    //mDNS queries run from loop() (runPendingMqttDiscovery); GET polls for
    //the cached result. 409 while a run is already in flight.
    webServer.on("/mqtt/discover", HTTP_POST, [](AsyncWebServerRequest * request) {
      SerialPrintln(F("Request for MQTT Broker Discovery Received"));
      if (mqttDiscoverPending) {
        request->send(409, "application/json", F("{\"status\":\"pending\"}"));
        return;
      }
      mqttDiscoverResultJson = String();
      mqttDiscoverPending = true;
      request->send(202, "application/json", F("{\"status\":\"pending\"}"));
    });
    webServer.on("/mqtt/discover", HTTP_GET, [](AsyncWebServerRequest * request) {
      if (mqttDiscoverPending) {
        request->send(200, "application/json", F("{\"status\":\"pending\"}"));
      } else if (mqttDiscoverResultJson.length() > 0) {
        request->send(200, "application/json", mqttDiscoverResultJson);
      } else {
        request->send(200, "application/json", F("{\"status\":\"idle\"}"));
      }
    });
#endif

    //Unit health (#45). GET serves the cached JSON snapshot (never touches the
    //Wire bus from async context); POST arms a re-poll drained in loop() by the
    //unitHealthRefreshPending block. Same defer pattern as /mqtt/discover.
    webServer.on("/units/health", HTTP_GET, [](AsyncWebServerRequest * request) {
      request->send(200, "application/json", unitHealthJson);
    });
    webServer.on("/units/health/refresh", HTTP_POST, [](AsyncWebServerRequest * request) {
      SerialPrintln(F("Request for Unit Health Refresh Received"));
      //Mirror the Wire-adjacent endpoints: a poll armed mid-flash would silently
      //no-op in pollUnitHealth(), so refuse it up front rather than returning a
      //misleading "pending" the client then can't distinguish from a real poll.
      if (firmwareFlashInProgress || unitReflashRunning) {
        request->send(503, "application/json", F("{\"status\":\"busy\"}"));
        return;
      }
      unitHealthRefreshPending = true;
      request->send(202, "application/json", F("{\"status\":\"pending\"}"));
    });

    webServer.on("/log", HTTP_GET, [](AsyncWebServerRequest * request) {
      //Don't SerialPrintln here; every log request would otherwise stamp
      //itself into the buffer on every poll and drown out real activity.
      request->send(200, "text/plain", webLogRead());
    });
    
    //POST, not GET (#145): a state-changing action must not be triggerable by
    //a drive-by <img src="/reboot"> on the LAN.
    webServer.on("/reboot", HTTP_POST, [](AsyncWebServerRequest * request) {
      SerialPrintln(F("Request to Reboot Received"));
      request->send(200, "text/plain",
        "Reboot pending — this takes 10-20 seconds. Reload the home page afterwards.");
      isPendingReboot = true;
    });

    //Remote recovery trigger (#53). Writes bootCounter = threshold to RTC
    //so the next boot enters recovery mode (known WiFi when the SDK has
    //credentials, SoftAP otherwise). Escape hatch for when an OTA
    //finishes at the HTTP level but the next boot crashes on something we
    //can't reach remotely — flipping into recovery gives back a clean,
    //minimal upload endpoint without pulling the device off the wall.
    webServer.on("/firmware/recover-mark", HTTP_POST, [](AsyncWebServerRequest * request) {
      SerialPrintln(F("Remote recovery mark requested — next boot -> recovery mode"));
      RtcBootState state = readBootStateRtc();
      state.bootCounter = RECOVERY_BOOT_THRESHOLD;
      writeBootStateRtc(state);
      request->send(202, "text/plain", "Recovery marker set; rebooting into recovery mode…");
      isPendingReboot = true;
    });

    //Reboot into quiet OTA mode (#117): the next boot serves only the
    //firmware endpoints — no I2C, no clock, no display traffic — so a
    //flash happens against the quietest possible supply. One-shot flag:
    //a reboot or power cycle out of OTA mode always lands in normal boot.
    webServer.on("/firmware/ota-mode", HTTP_POST, [](AsyncWebServerRequest * request) {
      SerialPrintln(F("OTA mode requested — next boot -> quiet OTA mode"));
      RtcBootState state = readBootStateRtc();
      state.bootMode = BOOT_MODE_OTA;
      state.bootCounter = 0;
      writeBootStateRtc(state);
      request->send(202, "text/plain", "OTA-mode marker set; rebooting into OTA mode…");
      isPendingReboot = true;
    });


    //GET /debug/ota — dumps the flash-layout numbers the Update class cares
    //about so we can tell from a browser whether web OTA should work at all.
    webServer.on("/debug/ota", HTTP_GET, [](AsyncWebServerRequest * request) {
      uint32_t freeSpace    = ESP.getFreeSketchSpace();
      uint32_t maxSketch    = (freeSpace - 0x1000) & 0xFFFFF000;
      String body;
      body += "sketchSize        = "; body += ESP.getSketchSize();         body += "\n";
      body += "freeSketchSpace   = "; body += freeSpace;                   body += "\n";
      body += "maxSketchSpace    = "; body += maxSketch;                   body += " (what Update.begin uses)\n";
      body += "flashChipSize     = "; body += ESP.getFlashChipSize();      body += "\n";
      body += "flashChipRealSize = "; body += ESP.getFlashChipRealSize();  body += "\n";
      body += "sketchMD5         = "; body += ESP.getSketchMD5();          body += "\n";
      body += "coreVersion       = "; body += ESP.getCoreVersion();        body += "\n";
      body += "version           = "; body += espVersion;                  body += "\n";
      request->send(200, "text/plain", body);
    });

    //POST /firmware/master — web OTA for the ESP itself. Receives a .bin
    //via multipart upload, flashes via the ESP8266 Update class, reboots.
    //Usable because the eagle.flash.1m.ld (no-FS) layout leaves ~1 MB for
    //sketch+staging — the 443 KB firmware has room for another 443 KB
    //staged image below _FS_start (which is 0xFB000 with no FS).
    //Handler lives in registerMasterFirmwareEndpoint() so recovery mode
    //can mount the same upload path on a minimal SoftAP. See issue #37.
    registerMasterFirmwareEndpoint();

    //Debug endpoint: tells a unit to reboot into its twiboot bootloader.
    //GET /unit/reboot?address=0x01 — useful without a HEX file to sanity-
    //check the enter-bootloader path (unit should disappear briefly and
    //twiboot show up on 0x29).
    //POST, not GET (#145): pushes a unit into its bootloader — state-changing.
    webServer.on("/unit/reboot", HTTP_POST, [](AsyncWebServerRequest * request) {
      //Same guard as the calibration endpoints: a stray byte on the Wire
      //bus mid-flash makes twiboot jump into half-written application
      //flash (any unknown command byte == CMD_BOOT_APPLICATION). See #95.
      if (firmwareFlashInProgress || unitReflashRunning) {
        request->send(503, "text/plain", "Unit firmware flash in progress — try again in a moment");
        return;
      }
      if (!request->hasParam("address")) {
        request->send(400, "text/plain", "Missing 'address' query param (e.g. /unit/reboot?address=0x01)");
        return;
      }
      String addressValue = request->getParam("address")->value();
      long parsedAddress = strtol(addressValue.c_str(), nullptr, 0);
      if (parsedAddress < 1 || parsedAddress > 126) {
        request->send(400, "text/plain", "Address must be 1..126");
        return;
      }
      int status = rebootUnitToBootloader((int)parsedAddress);
      if (status == 0) {
        request->send(200, "text/plain", "Reboot command sent. Unit should be in twiboot at 0x29 for ~1s.");
      } else {
        String body = "Wire.endTransmission returned ";
        body += status;
        request->send(502, "text/plain", body);
      }
    });

    //Interactive calibration endpoints (issue #32). All four share the
    //same preconditions: valid I2C address in the 1..126 range, and the
    //unit must be a sketch-running responder (we don't expose these to
    //units in bootloader mode or missing entirely). Guarded against the
    //firmware-flash window so we don't collide on the Wire bus.
    auto parseCalibrationAddress = [](AsyncWebServerRequest * request, int &outAddr) -> bool {
      if (firmwareFlashInProgress || unitReflashRunning) {
        request->send(503, "text/plain", "Unit firmware flash in progress — try again in a moment");
        return false;
      }
      if (!request->hasParam("address")) {
        request->send(400, "text/plain", "Missing 'address' query param");
        return false;
      }
      long parsed = strtol(request->getParam("address")->value().c_str(), nullptr, 0);
      if (parsed < 1 || parsed > 126) {
        request->send(400, "text/plain", "Address must be 1..126");
        return false;
      }
      int unitIndex = (int)parsed - 1;  // I2C_ADDRESS_BASE == 1
      if (unitIndex < 0 || unitIndex >= UNITS_AMOUNT ||
          detectedUnitStates[unitIndex] != 1) {
        request->send(404, "text/plain", "No sketch-running unit at that address");
        return false;
      }
      outAddr = (int)parsed;
      return true;
    };

    webServer.on("/unit/offset", HTTP_GET, [parseCalibrationAddress](AsyncWebServerRequest * request) {
      int addr = 0;
      if (!parseCalibrationAddress(request, addr)) return;
      int16_t offset = 0;
      if (!readUnitOffset(addr, offset)) {
        request->send(502, "text/plain", "Unit did not return a valid offset (firmware may predate #32)");
        return;
      }
      String body = "{\"offset\":";
      body += offset;
      body += "}";
      request->send(200, "application/json", body);
    });

    webServer.on("/unit/offset", HTTP_POST, [parseCalibrationAddress](AsyncWebServerRequest * request) {
      int addr = 0;
      if (!parseCalibrationAddress(request, addr)) return;
      if (!request->hasParam("value")) {
        request->send(400, "text/plain", "Missing 'value' query param");
        return;
      }
      long parsed = strtol(request->getParam("value")->value().c_str(), nullptr, 0);
      //±one drum revolution (#171): the unit clamps the same bound in its
      //SET_OFFSET path — past it, its post-homing rotation outruns the 8 s
      //watchdog. Rejecting here gives the calibration UI a real error
      //instead of a silently-dropped write.
      if (parsed < -SFP_OFFSET_LIMIT_STEPS || parsed > SFP_OFFSET_LIMIT_STEPS) {
        String msg = "Offset must be within +/-";
        msg += SFP_OFFSET_LIMIT_STEPS;
        msg += " steps (one revolution)";
        request->send(400, "text/plain", msg);
        return;
      }
      int status = writeUnitOffset(addr, (int16_t)parsed);
      if (status != 0) {
        String body = "Wire.endTransmission returned ";
        body += status;
        request->send(502, "text/plain", body);
        return;
      }
      request->send(200, "text/plain", "Offset written");
    });

    webServer.on("/unit/jog", HTTP_POST, [parseCalibrationAddress](AsyncWebServerRequest * request) {
      int addr = 0;
      if (!parseCalibrationAddress(request, addr)) return;
      if (!request->hasParam("steps")) {
        request->send(400, "text/plain", "Missing 'steps' query param");
        return;
      }
      long parsed = strtol(request->getParam("steps")->value().c_str(), nullptr, 0);
      if (parsed < -127 || parsed > 127) {
        request->send(400, "text/plain", "Steps must be -127..127");
        return;
      }
      int status = jogUnit(addr, (int)parsed);
      if (status != 0) {
        String body = "Wire.endTransmission returned ";
        body += status;
        request->send(502, "text/plain", body);
        return;
      }
      request->send(200, "text/plain", "Jogged");
    });

    webServer.on("/unit/home", HTTP_POST, [parseCalibrationAddress](AsyncWebServerRequest * request) {
      int addr = 0;
      if (!parseCalibrationAddress(request, addr)) return;
      int status = homeUnit(addr);
      if (status != 0) {
        String body = "Wire.endTransmission returned ";
        body += status;
        request->send(502, "text/plain", body);
        return;
      }
      request->send(200, "text/plain", "Home requested");
    });

    //POST /stop — user-visible kill-switch (issue #35). Aborts any running
    //showMessage() wait loop, broadcasts CMD_HOME to every unit in one I2C
    //transaction (issue #47 — previously N sequential sends), and clears
    //the in-memory text so the event loop doesn't immediately re-send the
    //previous message. Safe to call when nothing is happening; idempotent.
    webServer.on("/stop", HTTP_POST, [](AsyncWebServerRequest * request) {
      if (firmwareFlashInProgress || unitReflashRunning) {
        request->send(503, "text/plain", "Unit firmware flash in progress — try again in a moment");
        return;
      }
      SerialPrintln(F("Request to Stop Received"));
      //Abort immediately — showMessage's wait loop polls this flag every
      //~100 ms. The broadcast home + shared-text clears are deferred to the
      //isPendingStop drain in loop() (#150); the broadcast result lands in
      //the Log panel instead of this response.
      abortCurrentShow = true;
      isPendingStop = true;
      request->send(200, "text/plain",
        "Stop requested; homing all units. See the Log panel for the broadcast result.");
    });

    //GET /reflash-units — pushes sketch-running units whose firmware rev
    //does NOT match the bundled one (OUTDATED or UNKNOWN) into twiboot and
    //re-runs the PROGMEM auto-install. Units already on the bundled rev are
    //skipped (issue #114) — re-flashing them wastes time and flash cycles.
    //POST, not GET (#145): kicks off a bulk unit reflash — state-changing.
    webServer.on("/reflash-units", HTTP_POST, [](AsyncWebServerRequest * request) {
      //Same guard as the calibration endpoints — this handler owns the Wire
      //bus for a re-probe + flash pass and must not overlap an in-flight one.
      //Defer to loop() (#138): the bootloader entry + PROGMEM flash blocks for
      //many seconds streaming pages over I2C and must never run in the async
      //handler. Arm the flag and return immediately; runPendingUnitReflash()
      //does the throttled work and streams progress to the Log panel.
      if (firmwareFlashInProgress || reflashUnitsPending || unitReflashRunning) {
        request->send(503, "text/plain", "Unit firmware flash already in progress — try again in a moment");
        return;
      }
      SerialPrintln(F("Request to Reflash Units Received — queued for loop()"));
      reflashUnitsPending = true;
      request->send(200, "text/plain",
        "Reflash queued. Units are re-flashed 2 at a time — each pair must come "
        "back online and finish homing before the next, to limit power draw. "
        "Watch the Log panel for per-unit progress.");
    });

    //POST, not GET (#145): resets every unit's calibration — state-changing.
    webServer.on("/reset-units", HTTP_POST, [](AsyncWebServerRequest * request) {
      SerialPrintln(F("Request to Reset Units Received"));

      //This will be picked up in the loop
      isPendingUnitsReset = true;

      request->send(200, "text/plain",
        "Display is resetting/re-calibrating — this takes a few seconds. It shows "
        "different characters to carry this out, then returns to the last message.");
    });

    webServer.on("/", HTTP_POST, [](AsyncWebServerRequest * request) {
      SerialPrintln(F("Request Post of Form Received"));

      bool submissionError = false;

      String newAlignmentValue, newDeviceModeValue, newFlapSpeedValue, newInputTextValue, newTimezoneValue, newDeviceNameValue;
      String newMqttHostValue, newMqttPortValue, newMqttUserValue, newMqttPasswordValue;
      //Every field is optional (#128): the tabbed UI saves per card, so a
      //POST carries only the fields of the card that submitted it. A field
      //that wasn't provided must never be applied — otherwise a partial
      //save would blank the rest.
      bool alignmentProvided = false, deviceModeProvided = false, flapSpeedProvided = false, inputTextProvided = false;
      bool timezoneProvided = false;
      bool deviceNameProvided = false;
      bool mqttHostProvided = false, mqttPortProvided = false, mqttUserProvided = false, mqttPasswordProvided = false;

      int params = request->params();
      for (int paramIndex = 0; paramIndex < params; paramIndex++) {
        AsyncWebParameter* p = request->getParam(paramIndex);
        if (p->isPost()) {
          //HTTP POST alignment value
          if (p->name() == PARAM_ALIGNMENT) {
            String receivedValue = p->value();
            if (receivedValue == ALIGNMENT_MODE_LEFT || receivedValue == ALIGNMENT_MODE_CENTER || receivedValue == ALIGNMENT_MODE_RIGHT) {
              newAlignmentValue = receivedValue;
              alignmentProvided = true;
            }
            else {
              SerialPrintln("Alignment provided was not valid. Value: " + receivedValue);
              submissionError = true;
            }
          }

          //HTTP POST device mode value
          if (p->name() == PARAM_DEVICEMODE) {
            String receivedValue = p->value();
            if (receivedValue == DEVICE_MODE_TEXT || receivedValue == DEVICE_MODE_CLOCK) {
              newDeviceModeValue = receivedValue;
              deviceModeProvided = true;
            }
            else {
              SerialPrintln("Device Mode provided was not valid. Invalid Value: " + receivedValue);
              submissionError = true;
            }
          }

          //HTTP POST Flap Speed Slider value. The HTML slider enforces
          //1..100 client-side only — validate here like every other field
          //so a raw POST can't persist an out-of-range speed (#95).
          if (p->name() == PARAM_FLAP_SPEED) {
            String receivedValue = p->value();
            if (isNumber(receivedValue) && receivedValue.toInt() >= 1 && receivedValue.toInt() <= 100) {
              newFlapSpeedValue = receivedValue;
              flapSpeedProvided = true;
            }
            else {
              SerialPrintln("Flap speed provided was not valid. Value: " + receivedValue);
              submissionError = true;
            }
          }

          //HTTP POST inputText value
          if (p->name() == PARAM_INPUT_TEXT) {
            newInputTextValue = p->value().c_str();
            inputTextProvided = true;
          }

          //HTTP POST timezone POSIX TZ string (issue #48).
          //Accept empty (= UTC fallback) or a printable-ASCII string
          //short enough to fit the EEPROM slot; anything longer/weirder
          //is rejected rather than silently truncated.
          if (p->name() == PARAM_TIMEZONE) {
            String receivedValue = p->value();
            bool valid = (int)receivedValue.length() < LEN_TIMEZONE;
            for (size_t i = 0; valid && i < receivedValue.length(); i++) {
              char c = receivedValue[i];
              if (c < 0x20 || c > 0x7E) valid = false;
            }
            if (valid) {
              newTimezoneValue = receivedValue;
              timezoneProvided = true;
            } else {
              SerialPrintln("Timezone provided was not valid. Value: " + receivedValue);
              submissionError = true;
            }
          }

          //HTTP POST MQTT broker settings (#57). Host/user: printable
          //ASCII without spaces, must fit their EEPROM slots; empty host
          //disables MQTT. Port: empty (default 1883) or 1..65535.
          //Password is write-only: an empty field means "keep the stored
          //one", so it is only treated as provided when non-empty.
          if (p->name() == PARAM_MQTT_HOST || p->name() == PARAM_MQTT_USER) {
            bool isHost = p->name() == PARAM_MQTT_HOST;
            String receivedValue = p->value();
            receivedValue.trim();
            bool valid = (int)receivedValue.length() < (isHost ? LEN_MQTT_HOST : LEN_MQTT_USER);
            for (size_t i = 0; valid && i < receivedValue.length(); i++) {
              char c = receivedValue[i];
              if (c <= 0x20 || c > 0x7E) valid = false;
            }
            if (valid && isHost)       { newMqttHostValue = receivedValue; mqttHostProvided = true; }
            else if (valid)            { newMqttUserValue = receivedValue; mqttUserProvided = true; }
            else {
              SerialPrintln("MQTT " + String(isHost ? "host" : "user") + " provided was not valid. Value: " + receivedValue);
              submissionError = true;
            }
          }

          if (p->name() == PARAM_MQTT_PORT) {
            String receivedValue = p->value();
            receivedValue.trim();
            //Length bound too: "0001883" parses to 1883 but would truncate
            //to "00018" in the 6-byte slot — reject rather than corrupt.
            if (receivedValue.length() == 0 ||
                ((int)receivedValue.length() < LEN_MQTT_PORT &&
                 isNumber(receivedValue) && receivedValue.toInt() >= 1 && receivedValue.toInt() <= 65535)) {
              newMqttPortValue = receivedValue;
              mqttPortProvided = true;
            }
            else {
              SerialPrintln("MQTT port provided was not valid. Value: " + receivedValue);
              submissionError = true;
            }
          }

          if (p->name() == PARAM_MQTT_PASSWORD && p->value().length() > 0) {
            String receivedValue = p->value();
            bool valid = (int)receivedValue.length() < LEN_MQTT_PASSWORD;
            for (size_t i = 0; valid && i < receivedValue.length(); i++) {
              char c = receivedValue[i];
              if (c < 0x20 || c > 0x7E) valid = false;
            }
            if (valid) {
              newMqttPasswordValue = receivedValue;
              mqttPasswordProvided = true;
            }
            else {
              SerialPrintln(F("MQTT password provided was not valid (length/characters)."));
              submissionError = true;
            }
          }

          //HTTP POST device name (#125). Lowercased then validated as a
          //label safe for mDNS, hostname, MQTT topic segment and SSID at
          //once. Empty is valid and means "reset to the chip-id default".
          if (p->name() == PARAM_DEVICE_NAME) {
            String receivedValue = normalizeDeviceName(p->value());
            if (receivedValue.length() == 0 || isValidDeviceName(receivedValue)) {
              newDeviceNameValue = receivedValue;
              deviceNameProvided = true;
            } else {
              SerialPrintln("Device name provided was not valid. Value: " + receivedValue);
              submissionError = true;
            }
          }
        }
      }

      //Per-card fetch() saves (#128) send ajax=1 and want a status code
      //instead of the classic redirect; plain form posts keep the redirect
      //so old clients behave exactly as before.
      bool isAjax = request->hasParam("ajax", true);

      //If there was an error, report back to check what has been input
      if (submissionError) {
        SerialPrintln(F("Finished Processing Request with Error"));
        if (isAjax) request->send(400, "text/plain", F("invalid"));
        else request->redirect("/?invalid-submission=true");
      }
      else {
        SerialPrintln(F("Finished Processing Request Successfully"));

        //Compute the response verdict now, against the live values — the
        //apply itself is deferred (#150): shared-String mutation, EEPROM
        //commits and configTime run in applyPendingSettingsPost() from
        //loop(), never in this async handler. The drain is atomic wrt
        //handlers, so these comparisons can't race a half-applied post.
        bool deviceNameChanged = deviceNameProvided && deviceNameSetting != newDeviceNameValue;
        bool mqttChanged =
            (mqttHostProvided     && mqttHostSetting     != newMqttHostValue) ||
            (mqttPortProvided     && mqttPortSetting     != newMqttPortValue) ||
            (mqttUserProvided     && mqttUserSetting     != newMqttUserValue) ||
            (mqttPasswordProvided && mqttPasswordSetting != newMqttPasswordValue);

        //Stage the accepted fields; loop() drains them. Overlay semantics:
        //a second card's POST before the drain just adds its own fields.
        if (alignmentProvided)    { pendingSettingsPost.alignment    = newAlignmentValue;    pendingSettingsPost.alignmentProvided    = true; }
        if (flapSpeedProvided)    { pendingSettingsPost.flapSpeed    = newFlapSpeedValue;    pendingSettingsPost.flapSpeedProvided    = true; }
        if (deviceModeProvided)   { pendingSettingsPost.deviceMode   = newDeviceModeValue;   pendingSettingsPost.deviceModeProvided   = true; }
        if (inputTextProvided)    { pendingSettingsPost.inputText    = newInputTextValue;    pendingSettingsPost.inputTextProvided    = true; }
        if (timezoneProvided)     { pendingSettingsPost.timezone     = newTimezoneValue;     pendingSettingsPost.timezoneProvided     = true; }
        if (deviceNameProvided)   { pendingSettingsPost.deviceName   = newDeviceNameValue;   pendingSettingsPost.deviceNameProvided   = true; }
        if (mqttHostProvided)     { pendingSettingsPost.mqttHost     = newMqttHostValue;     pendingSettingsPost.mqttHostProvided     = true; }
        if (mqttPortProvided)     { pendingSettingsPost.mqttPort     = newMqttPortValue;     pendingSettingsPost.mqttPortProvided     = true; }
        if (mqttUserProvided)     { pendingSettingsPost.mqttUser     = newMqttUserValue;     pendingSettingsPost.mqttUserProvided     = true; }
        if (mqttPasswordProvided) { pendingSettingsPost.mqttPassword = newMqttPasswordValue; pendingSettingsPost.mqttPasswordProvided = true; }
        pendingSettingsPost.pending = true;

        if (isAjax) {
          //"ok-reboot" tells the card that its save needs a reboot to apply.
          request->send(200, "text/plain",
                        (deviceNameChanged || mqttChanged) ? F("ok-reboot") : F("ok"));
        }
        else {
          //Redirect so that we don't have the "re-submit form" problem in browser for refresh
          request->redirect(deviceNameChanged ? "/?device-name-saved=true"
                            : mqttChanged     ? "/?mqtt-saved=true"
                                              : "/");
        }
      }
    });

    //POST, not GET (#145): erasing WiFi credentials is the sharpest edge — a
    //drive-by <img src="/reset-wifi"> would have knocked the device offline.
    webServer.on("/reset-wifi", HTTP_POST, [](AsyncWebServerRequest * request) {
      SerialPrintln(F("Request to Reset WiFi Received"));
      request->send(200, "text/plain",
        "WiFi credentials erased. The display is rebooting into its setup portal — "
        "reconnect to the device's setup AP to configure a network.");
      isPendingWifiReset = true;
    });
}
