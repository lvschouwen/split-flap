// Firmware OTA for the Nano units.
//
// The master ships a compiled unit binary in PROGMEM (UNIT_FIRMWARE_BIN,
// generated by build_assets.py from ESPMaster/data/unit-firmware.hex) and
// auto-flashes any unit the boot probe finds sitting in twiboot.
//
// High-level flow of flashUnitFromProgmem():
//   1. beginFirmwareFlash(addr): if the unit is running the sketch, send the
//      enter-bootloader I2C opcode and wait for twiboot to come up. Our
//      patched twiboot listens on the unit's DIP-derived address (not stock
//      0x29), so every twiboot call targets `addr` directly.
//   2. Stream UNIT_FIRMWARE_BIN one 128-byte page at a time via
//      producePageToTwiboot.
//   3. finishFirmwareFlash(): exit the bootloader, verify the unit came back
//      up at its normal address.
//
// Twiboot protocol: see the comment in UnitBootloader/main.c around line 150.

#include "WebAssets.h"  // for UNIT_FIRMWARE_BIN / UNIT_FIRMWARE_BIN_LEN
#include "TwibootProtocol.h"

// ATmega328p flash is 32KB. Bootloader sits at 0x7C00; the rest is the app
// section we're allowed to write. Not currently enforced anywhere now that
// the only input is our own PROGMEM bundle, but kept for reference.
#define TWIBOOT_APP_MAX         0x7C00

volatile bool firmwareFlashInProgress = false;

// Deferred + throttled unit reflash (#138). POST /reflash-units arms
// reflashUnitsPending; loop() runs runPendingUnitReflash() so the multi-second
// blocking flash never stalls the async web handler. Units are flashed
// REFLASH_BATCH_SIZE at a time, waiting for each batch to come back online +
// finish homing before the next, so a supply shared with the steppers doesn't
// brown out from too many post-flash homing spikes at once.
volatile bool reflashUnitsPending = false;
// True for the whole duration of runPendingUnitReflash() (bootloader entry +
// throttled flash + every between-batch settle-wait). Every Wire-touching async
// endpoint checks this so a Jog/Home/Stop/offset request can't inject I2C into
// a settle window and corrupt an in-flight twiboot flash (#138).
volatile bool unitReflashRunning = false;
#define REFLASH_BATCH_SIZE       2
#define REFLASH_BATCH_SETTLE_MS  15000UL
// Wait after CMD_ENTER_BOOTLOADER before talking to twiboot: watchdog reset
// (~15 ms) + twiboot init. 500 ms is generous.
#define TWIBOOT_STARTUP_MS       500

// Minimal state for an in-flight PROGMEM flash. Previously this was a
// HexFlashState struct from HexFlashParser.h; that parser has been dropped
// along with the /firmware/unit web upload (see issue #23).
struct FirmwareFlashState {
  String   errorMsg;
  uint32_t totalBytesWritten;
};
static FirmwareFlashState flashState;
static uint8_t flashTargetI2cAddress = 0;
// Address used when talking to twiboot. Our DIP-patched bootloader listens on
// the unit's own I2C address (I2C_ADDRESS_BASE + DIP), so this is always set
// to the target unit's address at the start of a flash.
static uint8_t twibootAddr = 0;

// --- Twiboot I2C client --------------------------------------------------

static int twibootPing() {
  Wire.beginTransmission(twibootAddr);
  Wire.write((uint8_t)TWIBOOT_CMD_WAIT);
  return Wire.endTransmission();
}

static int twibootExit() {
  Wire.beginTransmission(twibootAddr);
  Wire.write((uint8_t)TWIBOOT_CMD_SWITCH_APPLICATION);
  Wire.write((uint8_t)TWIBOOT_BOOTTYPE_APPLICATION);
  return Wire.endTransmission();
}

// Queries twiboot chipinfo and checks it matches the ATmega328P. Populates
// `flashState.errorMsg` on mismatch.
static bool twibootVerifyChip() {
  Wire.beginTransmission(twibootAddr);
  Wire.write((uint8_t)TWIBOOT_CMD_ACCESS_MEMORY);
  Wire.write((uint8_t)TWIBOOT_MEMTYPE_CHIPINFO);
  Wire.write((uint8_t)0x00);
  Wire.write((uint8_t)0x00);
  if (Wire.endTransmission(false) != 0) {
    flashState.errorMsg = "Wire endTransmission failed reading chipinfo";
    return false;
  }
  uint8_t got = Wire.requestFrom(twibootAddr, (uint8_t)8);
  if (got != 8) {
    flashState.errorMsg = String("Chipinfo read returned ") + got + " bytes, expected 8";
    return false;
  }
  uint8_t sig0 = Wire.read(), sig1 = Wire.read(), sig2 = Wire.read();
  uint8_t pageSize = Wire.read();
  Wire.read(); Wire.read();  // flash size, unused
  Wire.read(); Wire.read();  // eeprom size, unused

  if (!isAtmega328pSignature(sig0, sig1, sig2)) {
    flashState.errorMsg = String("Unexpected chip signature ") + String(sig0, HEX) + " " +
                    String(sig1, HEX) + " " + String(sig2, HEX);
    return false;
  }
  if (pageSize != TWIBOOT_PAGE_SIZE) {
    flashState.errorMsg = String("Unexpected page size ") + pageSize;
    return false;
  }
  return true;
}

// Reads one 128-byte page back for post-write verification (issue #110).
// Same CMD_ACCESS_MEMORY framing as the write but with no payload, then a
// repeated-start read — the exact flow twiboot's own host tool uses for
// verify. Our m328p build has a real boot section (no VIRTUAL_BOOT_SECTION
// vector patching), so the read returns raw flash and must match the page
// we sent byte-for-byte.
static bool twibootReadFlashPage(uint16_t flashAddr, uint8_t* out) {
  Wire.beginTransmission(twibootAddr);
  Wire.write((uint8_t)TWIBOOT_CMD_ACCESS_MEMORY);
  Wire.write((uint8_t)TWIBOOT_MEMTYPE_FLASH);
  Wire.write((uint8_t)((flashAddr >> 8) & 0xFF));
  Wire.write((uint8_t)(flashAddr & 0xFF));
  if (Wire.endTransmission(false) != 0) return false;
  uint8_t got = Wire.requestFrom(twibootAddr, (uint8_t)TWIBOOT_PAGE_SIZE);
  if (got != TWIBOOT_PAGE_SIZE) {
    while (Wire.available()) Wire.read();
    return false;
  }
  for (int i = 0; i < TWIBOOT_PAGE_SIZE; i++) {
    out[i] = Wire.read();
  }
  return true;
}

// Writes exactly one page (SPM_PAGESIZE = 128 bytes on ATmega328p).
static int twibootWriteFlashPage(uint16_t flashAddr, const uint8_t* page) {
  Wire.beginTransmission(twibootAddr);
  Wire.write((uint8_t)TWIBOOT_CMD_ACCESS_MEMORY);
  Wire.write((uint8_t)TWIBOOT_MEMTYPE_FLASH);
  Wire.write((uint8_t)((flashAddr >> 8) & 0xFF));
  Wire.write((uint8_t)(flashAddr & 0xFF));
  for (int i = 0; i < TWIBOOT_PAGE_SIZE; i++) {
    Wire.write(page[i]);
  }
  return Wire.endTransmission();
}

// --- Page flush -----------------------------------------------------------

// Spin-poll twiboot with CMD_WAIT until it ACKs again (meaning its async
// flash-write finished) or we give up. Clock stretching is disabled in our
// patched twiboot build, so during the ~4.5 ms page-program window twiboot
// simply NACKs. Return true if twiboot is ready, false on timeout.
static bool twibootWaitReady(uint16_t timeoutMs) {
  uint32_t deadline = millis() + timeoutMs;
  while ((int32_t)(millis() - deadline) < 0) {
    if (twibootPing() == 0) return true;
    delay(1);
  }
  return false;
}

// Drains one 128-byte page to twiboot.
static bool producePageToTwiboot(const uint8_t* page, uint16_t addr) {
  SerialPrint(F("Writing page 0x"));
  SerialPrintln(String(addr, HEX));

  // Make sure twiboot is ready before hitting it with a 132-byte burst.
  if (!twibootWaitReady(100)) {
    flashState.errorMsg = String("twiboot not ready before page 0x") + String(addr, HEX);
    return false;
  }

  int status = twibootWriteFlashPage(addr, page);
  if (status != 0) {
    flashState.errorMsg = String("twibootWriteFlashPage failed at 0x") + String(addr, HEX) +
                          " status=" + String(status);
    return false;
  }

  // Wait for the async SPM cycle to finish. ~4.5 ms typical; 50 ms is
  // generous and still keeps the whole flash under a few seconds.
  if (!twibootWaitReady(50)) {
    flashState.errorMsg = String("twiboot stuck busy after page 0x") + String(addr, HEX);
    return false;
  }

  return true;
}

// Writes one page and reads it back to verify (issue #110), with one rewrite
// attempt on mismatch. On persistent failure the caller aborts while the
// unit is still sitting in twiboot — the boot-time auto-install retries
// later instead of the unit booting a corrupted sketch.
static bool flashAndVerifyPage(const uint8_t* page, uint16_t addr) {
  for (int attempt = 0; attempt < 2; attempt++) {
    if (!producePageToTwiboot(page, addr)) return false;

    uint8_t readBuf[TWIBOOT_PAGE_SIZE];
    if (!twibootReadFlashPage(addr, readBuf)) {
      flashState.errorMsg = String("Verify read failed at 0x") + String(addr, HEX);
      return false;
    }
    if (memcmp(readBuf, page, TWIBOOT_PAGE_SIZE) == 0) return true;

    SerialPrint(F("Verify mismatch at page 0x"));
    SerialPrint(String(addr, HEX));
    SerialPrintln(attempt == 0 ? F(" — rewriting once") : F(" — giving up"));
  }
  flashState.errorMsg = String("Verify mismatch persisted at 0x") + String(addr, HEX);
  return false;
}

// --- Public API ----------------------------------------------------------

bool beginFirmwareFlash(uint8_t i2cAddress, String& error) {
  if (firmwareFlashInProgress) {
    error = "A flash is already in progress";
    return false;
  }

  SerialPrint(F("Firmware flash starting, target 0x"));
  SerialPrintln(String(i2cAddress, HEX));

  // Our DIP-patched twiboot listens on the unit's own address, so that's
  // where every twiboot command must go.
  twibootAddr = i2cAddress;

  // If the unit is already sitting in twiboot, skip the reboot — sending
  // the enter-bootloader opcode to twiboot would be interpreted as the
  // unknown command 0x80. Probe with a chipinfo read.
  bool alreadyInBootloader = isUnitInBootloader((int)i2cAddress);

  if (!alreadyInBootloader) {
    int rebootStatus = rebootUnitToBootloader((int)i2cAddress);
    if (rebootStatus != 0) {
      error = String("Unit did not ack enter-bootloader (Wire status ") + rebootStatus + ")";
      return false;
    }
    SerialPrintln(F("Sent enter-bootloader opcode; waiting for twiboot"));
    delay(TWIBOOT_STARTUP_MS);
  } else {
    SerialPrintln(F("Unit already in bootloader; skipping reboot"));
  }

  bool bootloaderLive = false;
  for (int attempt = 0; attempt < 5; attempt++) {
    if (twibootPing() == 0) {
      bootloaderLive = true;
      break;
    }
    delay(100);
  }
  if (!bootloaderLive) {
    error = String("Twiboot not responding on 0x") + String(i2cAddress, HEX);
    return false;
  }
  SerialPrint(F("Twiboot responding on 0x"));
  SerialPrintln(String(i2cAddress, HEX));

  if (!twibootVerifyChip()) {
    error = flashState.errorMsg;
    return false;
  }
  SerialPrintln(F("Chip signature OK (ATmega328P, page=128)"));

  flashState.errorMsg          = "";
  flashState.totalBytesWritten = 0;
  flashTargetI2cAddress        = i2cAddress;

  firmwareFlashInProgress = true;
  return true;
}

bool finishFirmwareFlash(String& resultMsg) {
  if (!firmwareFlashInProgress) {
    resultMsg = "No flash in progress";
    return false;
  }

  uint8_t targetAddr = flashTargetI2cAddress;

  int exitStatus = twibootExit();
  if (exitStatus != 0) {
    resultMsg = String("Exit bootloader failed (Wire status ") + exitStatus + ")";
    firmwareFlashInProgress = false;
    return false;
  }

  uint32_t bytesWritten = flashState.totalBytesWritten;
  firmwareFlashInProgress = false;

  // Give the new sketch a couple of seconds to boot, then verify it
  // answers at its expected address.
  delay(2000);
  Wire.beginTransmission(targetAddr);
  int postFlashStatus = Wire.endTransmission();

  resultMsg = String("Flashed ") + bytesWritten + " bytes to 0x" + String(targetAddr, HEX);
  if (postFlashStatus == 0) {
    //Full hardware reboot (issue #113): twiboot's exit is a direct
    //jump_to_app(), not a reset. CMD_REBOOT gives the freshly flashed
    //sketch a clean watchdog reset (fresh peripherals/MCUSR, DIP + EEPROM
    //address re-read). The unit drains the flag after its initial homing,
    //so it homes, resets, and homes once more — slow but canonical.
    rebootUnit((int)targetAddr);
    resultMsg += " — unit responding; sent CMD_REBOOT for a clean restart";
    SerialPrintln(resultMsg);
  } else {
    resultMsg += String(" — WARNING: unit not responding post-flash (status ") + postFlashStatus + ")";
    SerialPrintln(resultMsg);
  }
  return true;
}

void abortFirmwareFlash(const String& reason) {
  SerialPrint(F("Aborting firmware flash: "));
  SerialPrintln(reason);
  firmwareFlashInProgress = false;
}

// Streams the PROGMEM-embedded unit firmware to twiboot one 128-byte page
// at a time.
bool flashUnitFromProgmem(uint8_t i2cAddress, String& resultMsg) {
  String beginError;
  if (!beginFirmwareFlash(i2cAddress, beginError)) {
    resultMsg = beginError;
    return false;
  }

  size_t pageCount = UNIT_FIRMWARE_BIN_LEN / TWIBOOT_PAGE_SIZE;
  uint8_t pageBuf[TWIBOOT_PAGE_SIZE];
  for (size_t pageIndex = 0; pageIndex < pageCount; pageIndex++) {
    memcpy_P(pageBuf, UNIT_FIRMWARE_BIN + pageIndex * TWIBOOT_PAGE_SIZE, TWIBOOT_PAGE_SIZE);
    uint16_t addr = (uint16_t)(pageIndex * TWIBOOT_PAGE_SIZE);
    if (!flashAndVerifyPage(pageBuf, addr)) {
      resultMsg = String("PROGMEM flash failed: ") + flashState.errorMsg;
      abortFirmwareFlash("PROGMEM flash page error");
      return false;
    }
    flashState.totalBytesWritten += TWIBOOT_PAGE_SIZE;
  }

  return finishFirmwareFlash(resultMsg);
}

// Called from setup() after probeI2cBus() has populated detectedUnitStates.
// For every unit the probe flagged as being in bootloader mode, stream the
// PROGMEM-embedded unit binary. Best-effort: one failure doesn't abort the
// others.
extern int detectedUnitStates[];
extern int detectedUnitVersionStatus[];
extern char detectedUnitVersions[][9];

void autoInstallFirmwareToBootloaderUnits() {
#if SERIAL_ENABLE == false
  int flashedCount = 0;
  int batch[REFLASH_BATCH_SIZE];
  int batchCount = 0;
  for (int unitIndex = 0; unitIndex < UNITS_AMOUNT; unitIndex++) {
    if (detectedUnitStates[unitIndex] != 2 /* bootloader */) continue;

    int i2cAddress = toI2cAddress(unitIndex);
    SerialPrint(F("Auto-flashing unit at 0x"));
    SerialPrint(String(i2cAddress, HEX));
    SerialPrint(F(" from PROGMEM ("));
    SerialPrint(UNIT_FIRMWARE_BIN_LEN);
    SerialPrintln(F(" bytes)"));

    String result;
    bool ok = flashUnitFromProgmem((uint8_t)i2cAddress, result);
    SerialPrint(ok ? "  [ok] " : "  [FAILED] ");
    SerialPrintln(result);
    if (ok) {
      //Just-provisioned unit is now running the sketch. Bump its state so
      //showMessage()/isDisplayMoving() stop skipping it.
      detectedUnitStates[unitIndex] = 1;
      //The streamed image IS the bundled firmware, page-verified against
      //PROGMEM during the flash (#110) — refresh the version cache in place
      //so the UI stops reporting the pre-flash "unknown" until the next
      //master reboot (#120). Re-reading over I2C here would race the unit's
      //post-flash CMD_REBOOT cycle and can pin twiboot alive (#88); the
      //boot-time probe re-confirms for real.
      strncpy(detectedUnitVersions[unitIndex], BUNDLED_UNIT_REV, 8);
      detectedUnitVersions[unitIndex][8] = '\0';
      detectedUnitVersionStatus[unitIndex] = 0;
      flashedCount++;
      batch[batchCount++] = unitIndex;
    }

    //Throttle (#138): once a batch is full, wait for those units to come back
    //online + finish homing before flashing more, so the post-flash homing
    //current can't brown out a supply shared with the steppers. Applies to both
    //the boot-time auto-install and the web /reflash-units path.
    if (batchCount >= REFLASH_BATCH_SIZE) {
      waitForReflashedBatchIdle(batch, batchCount, REFLASH_BATCH_SETTLE_MS);
      batchCount = 0;
    }
  }
  if (batchCount > 0) {
    waitForReflashedBatchIdle(batch, batchCount, REFLASH_BATCH_SETTLE_MS);
  }

  if (flashedCount > 0) {
    SerialPrint(F("Auto-install complete: "));
    SerialPrint(flashedCount);
    SerialPrintln(F(" unit(s) updated."));
  }
#endif
}

// Reboots every sketch-running unit whose firmware version the probe flagged
// as OUTDATED (status == 1) into twiboot, then re-probes and runs the usual
// PROGMEM auto-install path. Does nothing if no unit is outdated. Called at
// boot after the settled probe — so a display that boots up with one stale
// unit mixed in gets everyone on the same firmware without user action.
// See issue #32 (the user asked for this alongside interactive calibration).
//
// Safe re-entry: after auto-install the version cache reports the freshly
// flashed rev, which matches BUNDLED_UNIT_REV, so versionStatus flips to 0
// and a subsequent call is a no-op.

void autoUpdateOutdatedUnits() {
#if SERIAL_ENABLE == false
  int queued = 0;
  for (int unitIndex = 0; unitIndex < UNITS_AMOUNT; unitIndex++) {
    if (detectedUnitStates[unitIndex] != 1) continue;           // skip silent/bootloader
    if (detectedUnitVersionStatus[unitIndex] != 1) continue;    // skip ok/unknown
    int addr = toI2cAddress(unitIndex);
    SerialPrint(F("Unit at 0x"));
    SerialPrint(String(addr, HEX));
    SerialPrintln(F(" is OUTDATED — queuing auto-update"));
    if (rebootUnitToBootloader(addr) == 0) {
      queued++;
    }
  }
  if (queued == 0) return;

  SerialPrint(F("Queued "));
  SerialPrint(queued);
  SerialPrintln(F(" unit(s) for auto-update; waiting for twiboot"));
  delay(TWIBOOT_STARTUP_MS);
  probeI2cBus();
  autoInstallFirmwareToBootloaderUnits();
#endif
}

// Sends CMD_ENTER_BOOTLOADER to every unit the probe currently sees running
// the sketch (state == 1) on a firmware rev that does NOT match the bundled
// one — OUTDATED and UNKNOWN both qualify; units already on the bundled rev
// are skipped (issue #114). With reprobeAfter=true, waits ~500 ms for their
// watchdog resets + twiboot init and re-runs probeI2cBus() so a subsequent
// autoInstallFirmwareToBootloaderUnits() will catch them. Returns the
// number of units that ACKed the reboot command.
int enterBootloaderAllDetected(bool reprobeAfter) {
  int rebooted = 0;
  for (int unitIndex = 0; unitIndex < UNITS_AMOUNT; unitIndex++) {
    if (detectedUnitStates[unitIndex] != 1) continue;
    if (detectedUnitVersionStatus[unitIndex] == 0) continue;  // already on bundled rev (#114)
    int addr = toI2cAddress(unitIndex);
    if (rebootUnitToBootloader(addr) == 0) {
      rebooted++;
    }
  }
  if (rebooted > 0 && reprobeAfter) {
    delay(TWIBOOT_STARTUP_MS);
    probeI2cBus();
  }
  return rebooted;
}

// Polls a just-flashed batch until every unit answers AND reports not-rotating
// (homing finished), or the timeout elapses. checkIfMoving() returns 0 idle,
// 1 rotating, -1 offline/rebooting — so we wait on anything != 0. Bounds the
// number of units drawing homing current at once (#138).
static void waitForReflashedBatchIdle(const int* unitIndices, int count, unsigned long timeoutMs) {
  SerialPrint(F("  waiting for "));
  SerialPrint(count);
  SerialPrintln(F(" unit(s) to come online + finish homing..."));
  delay(1000);  // let finishFirmwareFlash()'s CMD_REBOOT take effect before polling
  unsigned long start = millis();
  while (millis() - start < timeoutMs) {
    bool allIdle = true;
    for (int k = 0; k < count; k++) {
      if (checkIfMoving(unitIndices[k]) != 0) { allIdle = false; break; }
    }
    if (allIdle) {
      SerialPrintln(F("  batch online + idle"));
      return;
    }
    delay(100);
  }
  SerialPrintln(F("  batch settle timed out — continuing anyway"));
}

// loop() drains the flag armed by POST /reflash-units (#138). Runs the blocking
// bootloader-entry + throttled flash here so the async web handler never stalls.
// autoInstallFirmwareToBootloaderUnits() is itself throttled, so boot-time
// auto-install and this web path share one paced flash. unitReflashRunning
// gates every other Wire-touching endpoint for the full duration so nothing
// injects I2C mid-flash.
void runPendingUnitReflash() {
  if (!reflashUnitsPending) return;
  reflashUnitsPending = false;
  unitReflashRunning = true;

  SerialPrintln(F("Deferred unit reflash starting (throttled)..."));
  int rebooted = enterBootloaderAllDetected(true);
  SerialPrint(F("Sent "));
  SerialPrint(rebooted);
  SerialPrintln(F(" sketch unit(s) not on the bundled rev into bootloader"));
  autoInstallFirmwareToBootloaderUnits();

  unitReflashRunning = false;
  SerialPrintln(F("Deferred unit reflash complete."));
}
